/*
 * Copyright (c) 2026 Adafruit Industries LLC
 *
 * SPDX-License-Identifier: Apache-2.0
 */

/dts-v1/;
#include "adafruit_circuitplayground_bluefruit_common.dtsi"
#include <nordic/nrf52840_partition.dtsi>

/ {
	model = "Adafruit Circuit Playground Bluefruit";
	compatible = "adafruit,circuitplayground-bluefruit";

	chosen {
		zephyr,console = &uart0;
		zephyr,shell-uart = &uart0;
		zephyr,uart-mcumgr = &uart0;
		zephyr,bt-mon-uart = &uart0;
		zephyr,bt-c2h-uart = &uart0;
	};
};
