/*
 * Copyright (c) 2026 Adafruit Industries LLC
 *
 * SPDX-License-Identifier: Apache-2.0
 */

/dts-v1/;
#include "adafruit_circuitplayground_bluefruit_common.dtsi"
#include <nordic/nrf52840_partition_uf2_sdv6.dtsi>
#include <../boards/common/usb/cdc_acm_serial.dtsi>

/ {
	model = "Adafruit Circuit Playground Bluefruit";
	compatible = "adafruit,circuitplayground-bluefruit-uf2";
};
