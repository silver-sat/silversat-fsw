## apps/command_ingest/Kconfig
```kconfig
# Command ingest (DS-50 to DS-54).

config SS_COMMAND_INGEST
	bool "Command ingest"
	depends on SS_MESSAGES
	select SS_CMD_AUTH
	select SS_CMD_COUNTER
	select SS_CMD_ROUTES
	select SS_EVENT
	select SS_LINK
	select SS_NVM
	help
	  Takes signed ground commands from the uplink queue, checks the
	  signature and counter, and routes each command to its target app.

if SS_COMMAND_INGEST

config SS_CMD_KEY_FILE_SLOT0
	string "Key file for key slot 0"
	default "tools/test_key.txt"
	help
	  A file of 64 hex digits; lines starting with '#' are ignored. A
	  relative path is from the root of this repository. The default is
	  the published test key. A flight build points this at a file written
	  from a CI secret, which is never committed (DS-54).

config SS_CMD_KEY_FILE_SLOT1
	string "Key file for key slot 1"
	default "tools/test_key_slot1.txt"
	help
	  The second key slot (DS-54). See SS_CMD_KEY_FILE_SLOT0.

config SS_CMD_REJECT_EVENT_SECONDS
	int "Seconds between events for a kind of rejection anyone can cause"
	default 60
	range 1 3600
	help
	  Rejections at the shape, signature, key and counter checks can be
	  caused by anyone with a transmitter, so their events are limited
	  (DS-10, DS-50): the first of a kind is an event at once, and while
	  more keep coming, one event each period carries how many there
	  were. At most two events per kind per period, however much is
	  transmitted, so a flood can't crowd other apps' events out of the
	  queue.

endif # SS_COMMAND_INGEST
```

## apps/frame_manager/Kconfig
```kconfig
# Frame manager (DS-20 to DS-25).

config SS_FRAME_MANAGER
	bool "Frame manager"
	depends on SS_MESSAGES
	help
	  Wakes each frame-driven app in its slots of the frame table for the
	  current mode.

config SS_FRAME_MANAGER_FLIGHT_TABLES
	bool "Use the flight frame tables"
	default y
	depends on SS_FRAME_MANAGER
	help
	  Compile apps/frame_manager/frame_tables.c. A test that needs its own
	  tables turns this off and defines frame_tables[] itself.
```

## apps/health/Kconfig
```kconfig
# Health (DS-43).

config SS_HEALTH
	bool "Health"
	depends on SS_MESSAGES
	select SS_NVM
	select HWINFO
	select WATCHDOG if $(dt_alias_enabled,watchdog0)
	# Each app's stack high-water mark (DS-44): stacks are filled with a
	# known pattern when each thread is created, and health finds each
	# app's thread by name.
	select INIT_STACKS
	select THREAD_STACK_INFO
	select THREAD_MONITOR
	select THREAD_NAME
	help
	  Watches every app's progress through the frame manager's report,
	  stops a stalled app's wakeups, restarts the ones whose re-enable
	  policy is AUTO, reports the app threads' stack high-water marks, and
	  is the only feeder of the hardware watchdog.

if SS_HEALTH

config SS_WATCHDOG_TIMEOUT_MS
	int "Hardware watchdog timeout (ms)"
	default 3000
	range 1500 30000
	help
	  Health feeds the watchdog once a major frame (1 s). 3 s tolerates
	  one late or missed feed and resets within a few seconds of a hang
	  (DS-43).

config SS_REENABLE_COOLDOWN_FRAMES
	int "Major frames before health restarts an AUTO app"
	default 10
	range 1 3600
	help
	  An app whose re-enable policy is REENABLE_AUTO is started again this
	  many major frames after health stopped it for a stall, up to its
	  auto_retry_cap times; after that only the ground restarts it
	  (DS-43).

config SS_STACK_MARGIN_BYTES
	int "Stack bytes an app should never use (bytes)"
	default 256
	range 0 65536
	help
	  Health sets stack_low in its housekeeping when any app's thread has
	  had less than this much of its stack unused (DS-44): its stack size
	  in the resource map should grow before it overflows.

config SS_RESET_LOOP_RUN_MINUTES
	int "A run shorter than this counts toward a reset loop (minutes)"
	default 10
	range 1 1440
	help
	  A run that ends sooner than this, by its last checkpoint, is a
	  short run (DS-44). Ten minutes is long enough for every app to have
	  run many major frames, so a fault that resets soon after boot is
	  caught.

config SS_RESET_LOOP_SAFE_RUNS
	int "Short runs in a row before health asks for safe mode"
	default 3
	range 2 16
	help
	  At this many short runs in a row, health asks the mode manager for
	  safe mode with reason reset_loop (DS-44).

config SS_RESET_LOOP_STOP_RUNS
	int "Short runs in a row before health stops every app that isn't protected"
	default 6
	range 2 16
	help
	  If the loop goes on, in safe mode too, health also stops every app
	  it watches that isn't protected, until the ground starts them again
	  (DS-44). At most 16, the boot log's length. Must be at least
	  SS_RESET_LOOP_SAFE_RUNS.

endif # SS_HEALTH
```

## apps/mode_manager/Kconfig
```kconfig
# Mode manager (DS-40, DS-41, DS-46).

config SS_MODE_MANAGER
	bool "Mode manager"
	depends on SS_MESSAGES
	select SS_EVENT
	select SS_NVM
	select GPIO if $(dt_alias_enabled,test-mode-signal)
	help
	  The only publisher of the spacecraft mode. Changes mode on ground
	  command or when a trigger fires, from a transition table, and runs
	  the actions table.

if SS_MODE_MANAGER

config SS_SEPARATION_DELAY_MINUTES
	int "Separation delay (minutes)"
	default 45
	range 1 1440
	help
	  How long after separation the spacecraft stays in deploy mode, in
	  which nothing transmits and the antenna is not deployed (DS-42,
	  DS-45). Timed from MET. The value comes from the launch provider's
	  interface document. The test signal at boot skips it.

config SS_COMMAND_LOSS_TIMEOUT_HOURS
	int "Command-loss timeout (hours)"
	default 168
	range 1 8760
	help
	  How long after the last accepted ground command the command-loss
	  timer fires: the spacecraft enters safe mode and stops all
	  transmission until the ground turns it back on (DS-46). The timer
	  starts at first contact. 168 hours is 7 days.

endif # SS_MODE_MANAGER
```

## apps/nvm/Kconfig
```kconfig
# The nvm app (DS-70, DS-74, DS-75).

config SS_NVM_APP
	bool "nvm app"
	depends on SS_MESSAGES
	select SS_EVENT
	select SS_NVM
	select SS_LINK
	help
	  Looks after the FRAM service: publishes its housekeeping, takes
	  the ground's retry and dump commands, and scrubs one region a
	  major frame.
```

## apps/radio/Kconfig
```kconfig
# Radio app (DS-32, DS-33).

config SS_RADIO
	bool "Radio app"
	depends on SS_MESSAGES
	depends on $(dt_alias_enabled,radio-uart)
	select SS_LINK
	select SS_LINK_CODEC
	select SERIAL
	select UART_INTERRUPT_DRIVEN
	select SS_NVM
	select RING_BUFFER
	help
	  Carries ground traffic between the radio's UART (the radio-uart
	  devicetree alias) and the uplink and downlink queues.
```

## apps/telemetry_output/Kconfig
```kconfig
# Telemetry output (DS-10, DS-69).

config SS_TELEMETRY_OUTPUT
	bool "Telemetry output"
	depends on SS_MESSAGES
	select SS_LINK
	select SS_TLM_ENCODE
	help
	  Sends each app's housekeeping to the ground through the downlink
	  queue, one app per major frame.
```

## apps/temperature/Kconfig
```kconfig
# The temperature app (DS-30, DS-31).

config SS_TEMPERATURE
	bool "Temperature app"
	depends on SS_MESSAGES
	select SS_EVENT
	select SENSOR if $(dt_alias_enabled,temperature-sensor)
	help
	  Reads the temperature sensor once a major frame and publishes it on
	  temperature_chan.

if SS_TEMPERATURE

config SS_TEMPERATURE_FAIL_LIMIT
	int "Failed readings in a row before a retry"
	default 3
	range 1 100
	help
	  After this many failed readings in a row, the app counts a reinit
	  and starts over (DS-31).

config SS_TEMPERATURE_REINIT_LIMIT
	int "Retries in a row before the sensor is marked failed"
	default 3
	range 1 100
	help
	  After this many reinits with no good reading between them, the app
	  marks the sensor failed, raises an event, and stops reading it
	  until the ground sends reinit (DS-31).

endif # SS_TEMPERATURE
```

## boards/adafruit/circuitplayground_bluefruit/board.yml
```yaml
board:
  name: adafruit_circuitplayground_bluefruit
  full_name: Circuit Playground Bluefruit
  vendor: adafruit
  socs:
    - name: nrf52840
      variants:
        - name: uf2
```

## dts/bindings/misc/silversat,test-mode-signal.yaml
```yaml
# Copyright (c) 2026 SilverSat
# SPDX-License-Identifier: Apache-2.0

description: |
  The external signal that puts the spacecraft in test mode at boot (DS-42).
  The mode manager reads it once, at its first wakeup. Point the
  test-mode-signal alias at a node with this compatible, or at any node with
  a gpios property, such as a gpio-keys button.

compatible: "silversat,test-mode-signal"

properties:
  gpios:
    type: phandle-array
    required: true
    description: The signal's pin. Active means test mode.
```

## dts/bindings/sensor/silversat,mag.yaml
```yaml
# Copyright (c) 2026 SilverSat
# SPDX-License-Identifier: Apache-2.0

description: |
  SilverSat three-axis magnetometer.

  The same binding is used for the real part on a hardware SPI bus and for
  the emulated part on zephyr,spi-emul-controller. Nothing in the driver or
  the application should need to know which one it is talking to -- that is
  the whole point.

compatible: "silversat,mag"

include: [sensor-device.yaml, spi-device.yaml]

properties:
  drdy-gpios:
    type: phandle-array
    description: |
      Data-ready interrupt line, if wired. Optional; the driver falls back
      to polling the status register when this is absent.
```

## lib/Kconfig
```kconfig
# Kconfig for libraries shared by apps.

menu "SilverSat libraries"

config SS_BLAKE2S
	bool "BLAKE2s (vendored reference implementation)"
	help
	  The BLAKE2 reference implementation of BLAKE2s, used for command
	  signatures (DS-52).

config SS_CMD_AUTH
	bool "Command authentication"
	select SS_BLAKE2S
	help
	  Shape check and signature check for signed ground commands
	  (DS-50 stages 1 and 2, DS-52).

config SS_CMD_COUNTER
	bool "Command counter"
	help
	  Replay protection for signed ground commands: the counter check
	  and the per-key-slot floor (DS-50 stage 3, DS-53). The floor is
	  held in RAM until the FRAM service exists.

config SS_CMD_COUNTER_RAM_FLOORS
	bool
	default y if SS_CMD_COUNTER && !SS_COMMAND_INGEST
	help
	  The counter floors in RAM, for a build without command ingest,
	  which keeps them in FRAM (DS-53, DS-70).

config SS_CMD_DELIVER
	bool "Command delivery"
	depends on SS_MESSAGES
	help
	  Publishes a command to an app's command channel, keeping at most
	  CMD_MAX_PENDING unhandled commands from each sender so the zbus
	  pool stays within its budget (DS-07). Used by the generated ground
	  command routing and internal command senders.

config SS_CMD_TEXT
	bool "Command text"
	help
	  Splits ground command text into words and reads typed arguments.
	  Used by the generated command routing (DS-50).

config SS_EVENT
	bool "Events"
	depends on SS_MESSAGES
	help
	  The queue that carries events from every app to telemetry output,
	  which downlinks them (DS-10). Emitting never waits: a full queue
	  drops the new event and counts it.

config SS_EVENT_QUEUE_DEBUG
	bool "Send debug events to the ground"
	default y if !SS_FLIGHT_BUILD
	depends on SS_EVENT
	help
	  Queue events of severity debug for the downlink, like any other.
	  Off in the flight build, where debug events would spend the radio
	  link on development detail (common.yaml's severity); they are still
	  logged when SS_EVENT_LOG is on.

config SS_EVENT_LOG
	bool "Log each event on the console (development)"
	default y if !SS_FLIGHT_BUILD
	depends on SS_EVENT && LOG
	help
	  Each event is also logged as it is raised, so the bench sees it at
	  once. Not in the flight build (DS-06).

config SS_NVM
	bool "FRAM service"
	depends on SS_MESSAGES
	select CRC
	select EEPROM if $(dt_alias_enabled,fram)
	select RETAINED_MEM if $(dt_alias_enabled,nvm-mirror)
	help
	  Records that survive a reset, in FRAM through Zephyr's EEPROM
	  API: two slots per record with generation and CRC, and the
	  record's default whenever it can't be read (DS-70, DS-71,
	  DS-75). A board without the fram alias runs with FRAM
	  unavailable. Records marked mirror: are also kept in the
	  nvm-mirror retained memory (the STM32's backup SRAM).

config SS_LINK
	bool "Link frame queues"
	depends on SS_MESSAGES
	help
	  The static queues that carry raw link frames between the radio app
	  and the apps that use them (DS-11): uplink to command ingest, and
	  downlink to the radio.

config SS_LINK_CODEC
	bool "Link codec"
	select CRC
	help
	  Frames for the serial links to the peer boards: KISS framing,
	  CRC-32C, and sequence numbers (DS-33, DS-65, DS-66).

endmenu
```

## tests/app/command_ingest/testcase.yaml
```yaml
common:
  tags:
    - app
    - command

tests:
  app.command_ingest:
    platform_allow:
      - native_sim
      - native_sim/native/64
```

## tests/app/frame_manager/testcase.yaml
```yaml
common:
  tags:
    - app
    - frame_manager

tests:
  app.frame_manager:
    platform_allow:
      - native_sim
      - native_sim/native/64
```

## tests/app/frame_tables/testcase.yaml
```yaml
common:
  tags:
    - app
    - frame

tests:
  app.frame_tables:
    platform_allow:
      - native_sim
      - native_sim/native/64
```

## tests/app/harness/testcase.yaml
```yaml
common:
  tags:
    - app

tests:
  app.harness:
    platform_allow:
      - native_sim
      - native_sim/native/64
```
