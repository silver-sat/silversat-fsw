## CMakeLists.txt
```
cmake_minimum_required(VERSION 3.20.0)

# One build for the shared libraries' tests: signing (cmd_auth), replay
# protection (cmd_counter), command text decoding and routing (cmd_route),
# the link codec (link_codec), the housekeeping and event encoders
# (tlm_encode), the FRAM service (nvm), the event queue (event), the
# generated message headers and channels (messages), and zbus scheduling
# (zbus_sched). Each keeps its own
# source file and test suite; they share a build only to save CI time, since
# most of a test's time is building Zephyr for it.

# typed_app has a command for every argument kind, and events.
set(SS_MESSAGES_EXTRA_APPS ${CMAKE_CURRENT_SOURCE_DIR}/apps)

# The fake FRAM's and mirror's bindings (app.overlay puts them behind the
# fram and nvm-mirror aliases).
set(FAKES ${CMAKE_CURRENT_SOURCE_DIR}/../../fakes)
list(APPEND DTS_ROOT ${FAKES})

find_package(Zephyr REQUIRED HINTS $ENV{ZEPHYR_BASE})
project(libs_test LANGUAGES C)

set(TOOLS ${CMAKE_CURRENT_SOURCE_DIR}/../../../tools)
set(VECTOR_DIR ${CMAKE_CURRENT_BINARY_DIR}/vectors)

# Signed packets from the ground's signer, with Python's own BLAKE2s.
add_custom_command(
  OUTPUT ${VECTOR_DIR}/signed_vectors.h
  COMMAND ${PYTHON_EXECUTABLE} ${TOOLS}/sign_command.py --c-vectors ${VECTOR_DIR}/signed_vectors.h
  DEPENDS ${TOOLS}/sign_command.py ${TOOLS}/test_key.txt
  COMMENT "Signing test vectors with tools/sign_command.py"
)

# Command text vectors, shared with the ground's tests.
add_custom_command(
  OUTPUT ${VECTOR_DIR}/route_vectors.h
  COMMAND ${PYTHON_EXECUTABLE} ${TOOLS}/command_text.py
          --vectors ${CMAKE_CURRENT_SOURCE_DIR}/command_vectors.yaml
          --c-vectors ${VECTOR_DIR}/route_vectors.h
  DEPENDS ${TOOLS}/command_text.py ${CMAKE_CURRENT_SOURCE_DIR}/command_vectors.yaml
  COMMENT "Converting the shared command text vectors"
)

# Link frames, encoded by the Python twin of the link codec.
add_custom_command(
  OUTPUT ${VECTOR_DIR}/link_vectors.h
  COMMAND ${PYTHON_EXECUTABLE} ${TOOLS}/link_codec.py
          --vectors ${CMAKE_CURRENT_SOURCE_DIR}/link_vectors.yaml
          --c-vectors ${VECTOR_DIR}/link_vectors.h
  DEPENDS ${TOOLS}/link_codec.py ${CMAKE_CURRENT_SOURCE_DIR}/link_vectors.yaml
  COMMENT "Encoding the link codec vectors with tools/link_codec.py"
)

# Housekeeping packets, encoded by the ground decoder's Python.
add_custom_command(
  OUTPUT ${VECTOR_DIR}/tlm_vectors.h
  COMMAND ${PYTHON_EXECUTABLE} ${TOOLS}/telemetry.py
          --extra-apps ${CMAKE_CURRENT_SOURCE_DIR}/apps
          --vectors ${CMAKE_CURRENT_SOURCE_DIR}/tlm_vectors.yaml
          --c-vectors ${VECTOR_DIR}/tlm_vectors.h
  DEPENDS ${TOOLS}/telemetry.py ${TOOLS}/command_text.py
          ${CMAKE_CURRENT_SOURCE_DIR}/tlm_vectors.yaml ${CMAKE_CURRENT_SOURCE_DIR}/apps/typed_app.yaml
  COMMENT "Encoding the housekeeping vectors with tools/telemetry.py"
)

# A FRAM image, laid out by the ground's dump decoder.
add_custom_command(
  OUTPUT ${VECTOR_DIR}/nvm_vectors.h
  COMMAND ${PYTHON_EXECUTABLE} ${TOOLS}/nvm_dump.py
          --vectors ${CMAKE_CURRENT_SOURCE_DIR}/nvm_vectors.yaml
          --c-image ${VECTOR_DIR}/nvm_vectors.h
  DEPENDS ${TOOLS}/nvm_dump.py ${TOOLS}/telemetry.py ${TOOLS}/link_codec.py
          ${TOOLS}/command_text.py ${CMAKE_CURRENT_SOURCE_DIR}/nvm_vectors.yaml
          ${CMAKE_CURRENT_SOURCE_DIR}/../../../messages/nvm_map.yaml
  COMMENT "Building the FRAM image vectors with tools/nvm_dump.py"
)

add_custom_target(libs_vectors
  DEPENDS ${VECTOR_DIR}/signed_vectors.h ${VECTOR_DIR}/route_vectors.h
          ${VECTOR_DIR}/link_vectors.h ${VECTOR_DIR}/tlm_vectors.h
          ${VECTOR_DIR}/nvm_vectors.h)
add_dependencies(app libs_vectors)

target_sources(app PRIVATE src/auth.c src/counter.c src/route.c src/link_codec.c
  src/tlm_encode.c src/nvm.c src/messages.c src/event.c src/zbus_sched.c ${FAKES}/fake_fram.c ${FAKES}/fake_retained_mem.c)
target_include_directories(app PRIVATE ${VECTOR_DIR} ${FAKES})
```

## prj.conf
```kconfig
CONFIG_ZTEST=y

CONFIG_SS_CMD_AUTH=y
CONFIG_SS_CMD_COUNTER=y
CONFIG_SS_LINK_CODEC=y
CONFIG_SS_MESSAGES=y
CONFIG_SS_CMD_ROUTES=y
CONFIG_SS_TLM_ENCODE=y
CONFIG_SS_EVENT=y
CONFIG_SS_NVM=y
CONFIG_EEPROM=y
CONFIG_RETAINED_MEM=y

# typed_app's set_all command is bigger than the default zbus buffer; the
# generated size check in msg_typed_app.c says so if this is too small.
CONFIG_ZBUS_MSG_SUBSCRIBER_NET_BUF_STATIC_DATA_SIZE=64

# Test apps on top of the flight apps need a bigger pool than the default.
# Some headroom here, so adding a flight app doesn't break this test;
# resource_map.h's check still fails the build if this is too small.
CONFIG_ZBUS_MSG_SUBSCRIBER_NET_BUF_POOL_SIZE=48
```

## app.overlay
```dts
/*
 * The FRAM and its mirror are fakes the tests can fail, tear, and corrupt
 * (tests/fakes/).
 */

/ {
	aliases {
		fram = &fake_fram;
		nvm-mirror = &fake_mirror;
	};

	fake_mirror: fake-mirror {
		compatible = "silversat,fake-retained-mem";
		status = "okay";
		size = <DT_SIZE_K(4)>;
	};

	fake_fram: fake-fram {
		compatible = "silversat,fake-fram";
		status = "okay";
		size = <DT_SIZE_K(32)>;
	};
};
```

## src/event.c
```c
/*
 * Tests for the event queue (DS-10) and the generated emit functions.
 *
 * SPDX-License-Identifier: Apache-2.0
 *
 * typed_app (apps/typed_app.yaml) defines three events: one with an app and
 * an enum argument, one with a plain number, and one with none.
 */

#include <errno.h>

#include <zephyr/ztest.h>

#include "msg/common.h"
#include "msg/typed_app.h"
#include "silversat/event.h"
#include "silversat/resource_map.h"

/* Each test starts with the queue empty. */
static void before(void *fixture)
{
	struct event event;

	ARG_UNUSED(fixture);
	while (event_take(&event) == 0) {
	}
}

ZTEST_SUITE(event, NULL, NULL, before, NULL, NULL);

ZTEST(event, test_emit_fills_in_the_event)
{
	struct event event;

	emit_typed_app_typed(1234, APP_ID_HEALTH, MODE_NOMINAL);
	zassert_ok(event_take(&event));
	zassert_equal(event.met_ms, 1234);
	zassert_equal(event.app, APP_ID_TYPED_APP);
	zassert_equal(event.severity, SEVERITY_WARNING);
	zassert_equal(event.id, TYPED_APP_EVENT_TYPED);
	zassert_equal(event.arg0, APP_ID_HEALTH);
	zassert_equal(event.arg1, MODE_NOMINAL);
}

ZTEST(event, test_unused_arguments_are_zero)
{
	struct event event;

	emit_typed_app_plain(-1, INT32_MIN);
	emit_typed_app_bare(0);
	zassert_ok(event_take(&event));
	zassert_equal(event.id, 513);
	zassert_equal(event.severity, SEVERITY_CRITICAL);
	zassert_equal(event.arg0, INT32_MIN);
	zassert_equal(event.arg1, 0);
	zassert_ok(event_take(&event));
	zassert_equal(event.id, 65535);
	zassert_equal(event.arg0, 0);
	zassert_equal(event.arg1, 0);
}

ZTEST(event, test_oldest_first)
{
	struct event event;

	for (int32_t i = 0; i < 3; i++) {
		emit_typed_app_plain(i, i);
	}
	for (int32_t i = 0; i < 3; i++) {
		zassert_ok(event_take(&event));
		zassert_equal(event.arg0, i);
	}
	zassert_equal(event_take(&event), -ENOMSG, "empty");
}

ZTEST(event, test_a_full_queue_keeps_the_oldest_and_counts_the_rest)
{
	struct event_stats start = event_stats();
	struct event event;

	for (int32_t i = 0; i < EVENT_QUEUE_DEPTH + 3; i++) {
		emit_typed_app_plain(i, i);
	}
	zassert_equal(event_stats().queued - start.queued, EVENT_QUEUE_DEPTH);
	zassert_equal(event_stats().dropped - start.dropped, 3);
	for (int32_t i = 0; i < EVENT_QUEUE_DEPTH; i++) {
		zassert_ok(event_take(&event));
		zassert_equal(event.arg0, i, "the first %d kept", EVENT_QUEUE_DEPTH);
	}
	zassert_equal(event_take(&event), -ENOMSG);
}
```

## src/link_codec.c
```c
/*
 * Tests for the link codec: KISS framing, CRC-32C, and sequence numbers
 * (DS-33, DS-65, DS-66).
 *
 * SPDX-License-Identifier: Apache-2.0
 *
 * The vectors come from the Python twin, tools/link_codec.py, at build
 * time, so the C codec must agree byte for byte with an independent
 * implementation (DS-92).
 */

#include <errno.h>
#include <string.h>

#include <zephyr/sys/crc.h>
#include <zephyr/ztest.h>

#include "link_vectors.h"
#include "silversat/link_codec.h"

static struct link_packet packet_from(const struct packet_vector *v)
{
	struct link_packet p = {.type = v->type, .seq = v->seq, .len = v->len};

	memcpy(p.payload, v->payload, v->len);
	return p;
}

static void assert_packet_matches(const struct link_packet *got, const struct packet_vector *v)
{
	zassert_equal(got->type, v->type, "%s: type", v->name);
	zassert_equal(got->seq, v->seq, "%s: seq", v->name);
	zassert_equal(got->len, v->len, "%s: len", v->name);
	zassert_mem_equal(got->payload, v->payload, v->len, "%s: payload", v->name);
}

ZTEST(link_codec, test_crc32c_check_value)
{
	/* DS-65: the check value for ASCII "123456789". */
	zassert_equal(crc32_c(0, (const uint8_t *)"123456789", 9, true, true), 0xE3069283);
}

ZTEST(link_codec, test_encoding_matches_python)
{
	for (size_t i = 0; i < ARRAY_SIZE(packet_vectors); i++) {
		const struct packet_vector *v = &packet_vectors[i];
		struct link_packet p = packet_from(v);
		uint8_t out[LINK_ENCODED_MAX];
		int len = link_encode(&p, out, sizeof(out));

		zassert_equal(len, (int)v->encoded_len, "%s: length", v->name);
		zassert_mem_equal(out, v->encoded, v->encoded_len, "%s: bytes", v->name);
	}
}

ZTEST(link_codec, test_decoding_matches_python)
{
	for (size_t i = 0; i < ARRAY_SIZE(stream_vectors); i++) {
		const struct stream_vector *v = &stream_vectors[i];
		struct link_decoder decoder;
		struct link_packet got;
		size_t n = 0;

		link_decoder_init(&decoder);
		for (size_t b = 0; b < v->len; b++) {
			enum link_decode_result r = link_decode_byte(&decoder, v->bytes[b], &got);

			if (r == LINK_DECODE_NONE) {
				continue;
			}
			zassert_true(n < v->expect_count, "%s: more results than expected", v->name);
			zassert_equal(r, v->expect[n].result, "%s: result %zu is %d, expected %d",
				      v->name, n, r, v->expect[n].result);
			if (r == LINK_DECODE_PACKET) {
				assert_packet_matches(&got, &packet_vectors[v->expect[n].packet]);
			}
			n++;
		}
		zassert_equal(n, v->expect_count, "%s: %zu results, expected %zu", v->name, n,
			      v->expect_count);
	}
}

ZTEST(link_codec, test_encode_needs_room)
{
	const struct packet_vector *v = &packet_vectors[0];
	struct link_packet p = packet_from(v);
	uint8_t out[LINK_ENCODED_MAX];

	for (size_t size = 0; size < v->encoded_len; size++) {
		zassert_equal(link_encode(&p, out, size), -ENOSPC, "room for %zu bytes", size);
	}
	zassert_equal(link_encode(&p, out, v->encoded_len), (int)v->encoded_len);
}

ZTEST(link_codec, test_worst_case_fits)
{
	/* Every byte escaped: LINK_ENCODED_MAX must still be enough. */
	struct link_packet p = {.type = KISS_FEND, .seq = KISS_FESC, .len = LINK_PAYLOAD_MAX};
	uint8_t out[LINK_ENCODED_MAX];

	memset(p.payload, KISS_FEND, sizeof(p.payload));
	zassert_true(link_encode(&p, out, sizeof(out)) > 0);
}

ZTEST(link_codec, test_sequence_numbers)
{
	struct link_seq tx;
	struct link_seq rx;

	link_seq_init(&tx);
	zassert_equal(link_seq_next(&tx), 0);
	zassert_equal(link_seq_next(&tx), 1);
	tx.next_tx = 255;
	zassert_equal(link_seq_next(&tx), 255);
	zassert_equal(link_seq_next(&tx), 0, "wraps after 255");

	link_seq_init(&rx);
	zassert_equal(link_seq_received(&rx, 10), 0, "the first frame sets the starting point");
	zassert_equal(link_seq_received(&rx, 11), 0);
	zassert_equal(link_seq_received(&rx, 14), 2, "12 and 13 were lost");
	zassert_equal(link_seq_received(&rx, 14), -1, "a repeat");
	zassert_equal(link_seq_received(&rx, 255), 240);
	zassert_equal(link_seq_received(&rx, 0), 0, "255 then 0 loses nothing");
	zassert_equal(link_seq_received(&rx, 254), 253);
	zassert_equal(link_seq_received(&rx, 1), 2, "255 and 0 were lost across the wrap");
}

ZTEST_SUITE(link_codec, NULL, NULL, NULL, NULL, NULL);
```

## src/messages.c
```c
/*
 * Tests for the generated message headers and channels (DS-60, DS-61, DS-68).
 *
 * SPDX-License-Identifier: Apache-2.0
 *
 * The generator's rules are tested in Python (messages/tests/). These tests
 * check what only a real build can: the generated C compiles, each channel
 * carries the type its header says, and an app's receive union works with
 * a message subscriber under ASan and UBSan.
 */

#include <errno.h>

#include <zephyr/kernel.h>
#include <zephyr/zbus/zbus.h>
#include <zephyr/ztest.h>

#include "msg/common.h"
#include "msg/frame_manager.h"

/*
 * Stands in for the frame manager's one pending point (DS-10). It listens
 * only while these tests run: the routing tests in this build send the
 * frame manager commands too, and one of them fills the zbus pool on
 * purpose, so a copy waiting here would take a buffer it counts on.
 */
ZBUS_MSG_SUBSCRIBER_DEFINE_WITH_ENABLE(test_sub, false);
ZBUS_CHAN_ADD_OBS(frame_manager_cmd_chan, test_sub, 3);

/* Every message an app receives must fit one buffer from the zbus pool. */
BUILD_ASSERT(sizeof(union frame_manager_msg) <= CONFIG_ZBUS_MSG_SUBSCRIBER_NET_BUF_STATIC_DATA_SIZE,
	     "raise CONFIG_ZBUS_MSG_SUBSCRIBER_NET_BUF_STATIC_DATA_SIZE");

/* Empty the subscriber's queue so each test starts clean. */
static void drain(void *fixture)
{
	const struct zbus_channel *chan;
	union frame_manager_msg msg;

	ARG_UNUSED(fixture);
	while (zbus_sub_wait_msg(&test_sub, &chan, &msg, K_NO_WAIT) == 0) {
	}
}

static void *listen(void)
{
	zassert_ok(zbus_obs_set_enable(&test_sub, true));
	return NULL;
}

static void stop_listening(void *fixture)
{
	ARG_UNUSED(fixture);
	zassert_ok(zbus_obs_set_enable(&test_sub, false));
	drain(NULL);
}

ZTEST_SUITE(messages, NULL, listen, drain, NULL, stop_listening);

ZTEST(messages, test_ids_match_the_yaml)
{
	zassert_equal(APP_ID_FRAME_MANAGER, 1);
	zassert_equal(FRAME_MANAGER_CMD_SET_ENTRY_ENABLED, 1);
	zassert_equal(SEVERITY_DEBUG, 0);
	zassert_equal(SEVERITY_CRITICAL, 4);
}

ZTEST(messages, test_channels_carry_their_types)
{
	zassert_equal(zbus_chan_msg_size(&frame_manager_cmd_chan),
		      sizeof(struct frame_manager_cmd));
	zassert_equal(zbus_chan_msg_size(&frame_manager_hk_chan),
		      sizeof(struct frame_manager_hk));
	zassert_equal(zbus_chan_msg_size(&frame_manager_status_chan),
		      sizeof(struct app_status));
}

ZTEST(messages, test_commands_are_queued_not_overwritten)
{
	/*
	 * DS-11: two commands published back to back both arrive, in order.
	 * A plain subscriber would see only the second.
	 */
	const struct frame_manager_cmd first = {
		.id = FRAME_MANAGER_CMD_SET_ENTRY_ENABLED,
		.args.set_entry_enabled = {.mode = MODE_SAFE, .entry = 3, .enabled = false},
	};
	const struct frame_manager_cmd second = {
		.id = FRAME_MANAGER_CMD_SET_ENTRY_ENABLED,
		.args.set_entry_enabled = {.mode = MODE_NOMINAL, .entry = 4, .enabled = true},
	};
	const struct zbus_channel *chan;
	union frame_manager_msg msg;

	zassert_ok(zbus_chan_pub(&frame_manager_cmd_chan, &first, K_NO_WAIT));
	zassert_ok(zbus_chan_pub(&frame_manager_cmd_chan, &second, K_NO_WAIT));

	zassert_ok(zbus_sub_wait_msg(&test_sub, &chan, &msg, K_NO_WAIT));
	zassert_equal_ptr(chan, &frame_manager_cmd_chan);
	zassert_equal(msg.cmd.id, FRAME_MANAGER_CMD_SET_ENTRY_ENABLED);
	zassert_equal(msg.cmd.args.set_entry_enabled.mode, MODE_SAFE);
	zassert_equal(msg.cmd.args.set_entry_enabled.entry, 3);
	zassert_false(msg.cmd.args.set_entry_enabled.enabled);

	zassert_ok(zbus_sub_wait_msg(&test_sub, &chan, &msg, K_NO_WAIT));
	zassert_equal_ptr(chan, &frame_manager_cmd_chan);
	zassert_equal(msg.cmd.args.set_entry_enabled.mode, MODE_NOMINAL);
	zassert_equal(msg.cmd.args.set_entry_enabled.entry, 4);
	zassert_true(msg.cmd.args.set_entry_enabled.enabled);

	zassert_equal(zbus_sub_wait_msg(&test_sub, &chan, &msg, K_NO_WAIT), -ENOMSG);
}

ZTEST(messages, test_status_channel_round_trip)
{
	/*
	 * Status channels are declared in msg/common.h, so the frame manager
	 * and health can read any app's status (DS-22, DS-43).
	 */
	const struct app_status sent = {.steps = 7, .cmd_accepted = 2, .cmd_rejected = 1};
	struct app_status got;

	zassert_ok(zbus_chan_pub(&frame_manager_status_chan, &sent, K_NO_WAIT));
	zassert_ok(zbus_chan_read(&frame_manager_status_chan, &got, K_NO_WAIT));
	zassert_mem_equal(&got, &sent, sizeof(got));
}

ZTEST(messages, test_housekeeping_channel_is_last_value)
{
	/* Telemetry channels keep only the newest value (DS-11). */
	const struct frame_manager_hk older = {.frame_count = 10, .mode = MODE_SAFE};
	const struct frame_manager_hk newer = {.frame_count = 20, .mode = MODE_NOMINAL};
	struct frame_manager_hk got;

	zassert_ok(zbus_chan_pub(&frame_manager_hk_chan, &older, K_NO_WAIT));
	zassert_ok(zbus_chan_pub(&frame_manager_hk_chan, &newer, K_NO_WAIT));
	zassert_ok(zbus_chan_read(&frame_manager_hk_chan, &got, K_NO_WAIT));
	zassert_equal(got.frame_count, 20);
	zassert_equal(got.mode, MODE_NOMINAL);
}
```

## src/nvm.c
```c
/*
 * Tests for the FRAM service (DS-70, DS-71, DS-75).
 *
 * SPDX-License-Identifier: Apache-2.0
 *
 * The FRAM is a fake (tests/fakes/fake_fram.c) that the tests can fail,
 * tear a write on, or corrupt. Most tests use a region made here by hand;
 * flight code only ever uses the regions the generator writes from
 * messages/nvm_map.yaml, and the last tests use those: one round trip, and
 * an image of FRAM built by the ground's dump decoder (nvm_vectors.yaml).
 */

#include <errno.h>
#include <string.h>

#include <zephyr/sys/byteorder.h>
#include <zephyr/sys/crc.h>
#include <zephyr/ztest.h>

#include "fake_fram.h"
#include "fake_retained_mem.h"
#include "nvm/command_ingest.h"
#include "nvm/health.h"
#include "nvm/sizes.h"
#include "nvm_vectors.h"
#include "silversat/nvm.h"
#include "silversat/resource_map.h"

static const struct device *const fram = DEVICE_DT_GET(FRAM_NODE);
static const struct device *const mirror = DEVICE_DT_GET(NVM_MIRROR_NODE);

static const uint8_t defaults[4] = {0xd0, 0xd1, 0xd2, 0xd3};

static const struct nvm_region region = {
	.name = "test",
	.address = 0x100,
	.size = 4,
	.version = 1,
	.defaults = defaults,
};

/* The same record, also kept in the mirror (at another address there). */
static const struct nvm_region mirrored = {
	.name = "mirrored",
	.address = 0x200,
	.size = 4,
	.version = 1,
	.defaults = defaults,
	.mirrored = true,
	.mirror_address = 0x40,
};

/* The same place in FRAM, as the next version of the software would see it. */
static const struct nvm_region region_v2 = {
	.name = "test",
	.address = 0x100,
	.size = 4,
	.version = 2,
	.defaults = defaults,
};

static const uint8_t a[4] = {1, 2, 3, 4};
static const uint8_t b[4] = {5, 6, 7, 8};
static const uint8_t c[4] = {9, 10, 11, 12};

#define SLOT_SIZE NVM_SLOT_SIZE(4)

static uint8_t *slot(int n)
{
	return &fake_fram_memory(fram)[region.address + n * SLOT_SIZE];
}

static uint32_t generation(int n)
{
	return sys_get_le32(&slot(n)[4]);
}

/* Rewrite a slot's generation and fix its CRC, as if it had been written so. */
static void set_generation(int n, uint32_t gen)
{
	sys_put_le32(gen, &slot(n)[4]);
	sys_put_le32(crc32_c(0, slot(n), SLOT_SIZE - NVM_CRC_LEN, true, true),
		     &slot(n)[SLOT_SIZE - NVM_CRC_LEN]);
}

/* Read the test region, check the result code, and return a pointer to it. */
static const uint8_t *read_expect(int expected_rc)
{
	static uint8_t payload[4];

	zassert_equal(nvm_read(&region, payload), expected_rc);
	return payload;
}

/* Each test starts with a blank, working FRAM and mirror. */
static void before(void *fixture)
{
	ARG_UNUSED(fixture);
	fake_fram_reset(fram);
	fake_retained_mem_reset(mirror);
	zassert_ok(nvm_retry());
	zassert_true(nvm_mirror_available());
}

ZTEST_SUITE(nvm, NULL, NULL, before, NULL, NULL);

ZTEST(nvm, test_blank_fram_reads_the_default)
{
	zassert_mem_equal(read_expect(-ENOENT), defaults, 4);
	zassert_true(nvm_available(), "blank is not a fault");
}

ZTEST(nvm, test_write_then_read)
{
	zassert_ok(nvm_write(&region, a));
	zassert_mem_equal(read_expect(0), a, 4);
}

ZTEST(nvm, test_writes_alternate_slots_and_the_newest_wins)
{
	zassert_ok(nvm_write(&region, a));
	zassert_ok(nvm_write(&region, b));
	zassert_ok(nvm_write(&region, c));
	zassert_mem_equal(read_expect(0), c, 4);
	zassert_equal(generation(0), 3, "a, then c over it");
	zassert_equal(generation(1), 2, "b, the previous value, still there");
	zassert_mem_equal(&slot(1)[NVM_HEADER_LEN], b, 4);
}

ZTEST(nvm, test_slot_layout)
{
	zassert_ok(nvm_write(&region, a));
	zassert_equal(sys_get_le16(&slot(0)[0]), NVM_MAGIC);
	zassert_equal(slot(0)[2], 1, "version");
	zassert_equal(slot(0)[3], 4, "length");
	zassert_equal(generation(0), 1);
	zassert_mem_equal(&slot(0)[NVM_HEADER_LEN], a, 4);
	zassert_equal(sys_get_le32(&slot(0)[NVM_HEADER_LEN + 4]),
		      crc32_c(0, slot(0), NVM_HEADER_LEN + 4, true, true), "CRC-32C over the rest");
}

ZTEST(nvm, test_torn_write_keeps_the_previous_value)
{
	zassert_ok(nvm_write(&region, a));
	/* Power fails part-way through writing b over the other slot. */
	fake_fram_tear_next_write(fram, NVM_HEADER_LEN + 2);
	zassert_equal(nvm_write(&region, b), -EIO);

	/* After the reset that follows: */
	zassert_ok(nvm_retry());
	zassert_mem_equal(read_expect(0), a, 4);
	zassert_true(nvm_available(), "one bad slot is a torn write, not a failed part");
}

ZTEST(nvm, test_a_corrupt_slot_falls_back_to_the_other)
{
	uint32_t bad = nvm_stats().bad_slots;

	zassert_ok(nvm_write(&region, a));
	zassert_ok(nvm_write(&region, b));
	slot(1)[NVM_HEADER_LEN] ^= 0x01;
	zassert_mem_equal(read_expect(0), a, 4);
	zassert_equal(nvm_stats().bad_slots - bad, 1);
	zassert_true(nvm_available(), "one bad slot is not a failed part");

	/* The next write replaces the corrupt slot, not the good one. */
	zassert_ok(nvm_write(&region, c));
	zassert_mem_equal(read_expect(0), c, 4);
	zassert_mem_equal(&slot(0)[NVM_HEADER_LEN], a, 4);
}

ZTEST(nvm, test_a_slot_of_the_wrong_length_is_bad)
{
	uint32_t bad = nvm_stats().bad_slots;

	/* This version, a valid CRC, but a length this record can't have. */
	zassert_ok(nvm_write(&region, a));
	slot(0)[3] = 3;
	set_generation(0, 1);
	zassert_mem_equal(read_expect(-ENOENT), defaults, 4);
	zassert_equal(nvm_stats().bad_slots - bad, 1);
}

ZTEST(nvm, test_both_slots_corrupt_is_a_failure)
{
	zassert_ok(nvm_write(&region, a));
	zassert_ok(nvm_write(&region, b));
	slot(0)[NVM_HEADER_LEN] ^= 0x01;
	slot(1)[NVM_HEADER_LEN] ^= 0x01;
	zassert_mem_equal(read_expect(-EIO), defaults, 4);
	zassert_false(nvm_available(), "FRAM degraded (DS-75)");
}

ZTEST(nvm, test_another_version_reads_the_default)
{
	zassert_ok(nvm_write(&region, a));
	zassert_equal(nvm_read(&region_v2, (uint8_t[4]){0}), -ENOENT);
	zassert_true(nvm_available(), "a new version of the software is not a fault");

	/* The new version writes its own record, and reads it back. */
	zassert_ok(nvm_write(&region_v2, b));
	{
		uint8_t payload[4];

		zassert_ok(nvm_read(&region_v2, payload));
		zassert_mem_equal(payload, b, 4);
	}
}

ZTEST(nvm, test_generation_wraps)
{
	zassert_ok(nvm_write(&region, a));
	set_generation(0, UINT32_MAX);
	zassert_ok(nvm_write(&region, b));
	zassert_equal(generation(1), 0, "the generation wrapped");
	zassert_mem_equal(read_expect(0), b, 4, "0 is newer than UINT32_MAX (DS-71)");
}

ZTEST(nvm, test_dead_part_gives_defaults_until_retried)
{
	zassert_ok(nvm_write(&region, a));
	fake_fram_fail(fram, true);
	zassert_mem_equal(read_expect(-EIO), defaults, 4);
	zassert_false(nvm_available());
	zassert_equal(nvm_write(&region, b), -EIO);

	/* Working again, but unused until the retry the ground commands. */
	fake_fram_fail(fram, false);
	zassert_mem_equal(read_expect(-EIO), defaults, 4);
	zassert_ok(nvm_retry());
	zassert_mem_equal(read_expect(0), a, 4);
}

ZTEST(nvm, test_a_part_too_small_for_the_map_goes_unused)
{
	/* A smaller FRAM than the map was laid out for: run without it. */
	fake_fram_report_size(fram, NVM_FRAM_USED - 1);
	zassert_equal(nvm_retry(), -EIO);
	zassert_false(nvm_available());
	zassert_true(nvm_mirror_available(), "the mirror carries on");
	zassert_equal(nvm_write(&region, a), -EIO);

	/* Exactly big enough is enough. */
	fake_fram_report_size(fram, NVM_FRAM_USED);
	zassert_ok(nvm_retry());
	zassert_true(nvm_available());
}

ZTEST(nvm, test_a_mirror_too_small_for_the_map_goes_unused)
{
	fake_retained_mem_report_size(mirror, NVM_MIRROR_USED - 1);
	zassert_ok(nvm_retry(), "FRAM still works");
	zassert_false(nvm_mirror_available());

	fake_retained_mem_report_size(mirror, NVM_MIRROR_USED);
	zassert_ok(nvm_retry());
	zassert_true(nvm_mirror_available());
}

ZTEST(nvm, test_a_write_that_does_not_stick_is_a_failure)
{
	fake_fram_drop_writes(fram, true);
	zassert_equal(nvm_write(&region, a), -EIO, "caught by the read-back");
	zassert_false(nvm_available());
}

ZTEST(nvm, test_stats)
{
	struct nvm_stats before = nvm_stats();

	(void)nvm_read(&region, (uint8_t[4]){0});
	zassert_ok(nvm_write(&region, a));
	(void)nvm_read(&region, (uint8_t[4]){0});
	fake_fram_fail(fram, true);
	(void)nvm_read(&region, (uint8_t[4]){0});

	zassert_equal(nvm_stats().reads - before.reads, 3);
	zassert_equal(nvm_stats().writes - before.writes, 1);
	zassert_equal(nvm_stats().defaults_used - before.defaults_used, 2, "blank, then failed");
	zassert_equal(nvm_stats().errors - before.errors, 1);
}

/* ---- The mirror (DS-75's second tier) ----------------------------------- */

static uint8_t *mirror_slot(int n)
{
	return &fake_retained_mem_memory(mirror)[mirrored.mirror_address + n * SLOT_SIZE];
}

static int read_mirrored(uint8_t *payload)
{
	return nvm_read(&mirrored, payload);
}

ZTEST(nvm, test_a_mirrored_record_is_written_to_both)
{
	zassert_ok(nvm_write(&mirrored, a));
	zassert_mem_equal(&fake_fram_memory(fram)[mirrored.address + NVM_HEADER_LEN], a, 4);
	zassert_mem_equal(&mirror_slot(0)[NVM_HEADER_LEN], a, 4);
	zassert_equal(sys_get_le32(&mirror_slot(0)[4]), 1, "the same generation in both");
}

ZTEST(nvm, test_an_unmirrored_record_never_touches_the_mirror)
{
	static const uint8_t blank[64];

	zassert_ok(nvm_write(&region, a));
	zassert_mem_equal(fake_retained_mem_memory(mirror), blank, sizeof(blank));
}

ZTEST(nvm, test_the_mirror_answers_when_fram_fails)
{
	uint8_t payload[4];
	uint32_t from_mirror = nvm_stats().from_mirror;

	zassert_ok(nvm_write(&mirrored, a));
	fake_fram_fail(fram, true);
	zassert_ok(read_mirrored(payload), "a stored record, from the mirror");
	zassert_mem_equal(payload, a, 4);
	zassert_false(nvm_available());
	zassert_equal(nvm_stats().from_mirror - from_mirror, 1);

	/* Writes go on to the mirror alone, and count as stored. */
	zassert_ok(nvm_write(&mirrored, b));
	zassert_ok(read_mirrored(payload));
	zassert_mem_equal(payload, b, 4);
}

ZTEST(nvm, test_the_newest_copy_wins_after_fram_returns)
{
	uint8_t payload[4];

	/* FRAM fails after a; b and c reach the mirror only. */
	zassert_ok(nvm_write(&mirrored, a));
	fake_fram_fail(fram, true);
	(void)read_mirrored(payload);
	zassert_ok(nvm_write(&mirrored, b));
	zassert_ok(nvm_write(&mirrored, c));

	/* FRAM works again, still holding a: the mirror's c is newer. */
	fake_fram_fail(fram, false);
	zassert_ok(nvm_retry());
	zassert_ok(read_mirrored(payload));
	zassert_mem_equal(payload, c, 4);

	/* The next write follows the newest generation in either store. */
	zassert_ok(nvm_write(&mirrored, a));
	zassert_equal(sys_get_le32(&fake_fram_memory(fram)[mirrored.address + SLOT_SIZE + 4]), 4,
		      "after the mirror's 3, in FRAM's older slot");
	zassert_ok(read_mirrored(payload));
	zassert_mem_equal(payload, a, 4);
}

ZTEST(nvm, test_no_fram_at_all_keeps_mirrored_records)
{
	uint8_t payload[4];

	/* Like the Nucleo before the part is chosen: FRAM never works. */
	fake_fram_fail(fram, true);
	(void)nvm_retry();
	zassert_equal(read_mirrored(payload), -ENOENT, "the mirror is blank, not failed");
	zassert_ok(nvm_write(&mirrored, b));
	zassert_ok(read_mirrored(payload));
	zassert_mem_equal(payload, b, 4);

	/* An unmirrored record can't be stored anywhere. */
	zassert_equal(nvm_write(&region, a), -EIO);
	zassert_mem_equal(read_expect(-EIO), defaults, 4);
}

ZTEST(nvm, test_a_failed_mirror_leaves_fram)
{
	uint8_t payload[4];

	fake_retained_mem_fail(mirror, true);
	zassert_ok(nvm_write(&mirrored, a), "stored in FRAM");
	zassert_false(nvm_mirror_available());
	zassert_true(nvm_available());
	zassert_ok(read_mirrored(payload));
	zassert_mem_equal(payload, a, 4);
}

ZTEST(nvm, test_both_failed_gives_the_default)
{
	uint8_t payload[4];

	zassert_ok(nvm_write(&mirrored, a));
	fake_fram_fail(fram, true);
	fake_retained_mem_fail(mirror, true);
	zassert_equal(nvm_write(&mirrored, b), -EIO);
	zassert_equal(read_mirrored(payload), -EIO);
	zassert_mem_equal(payload, defaults, 4);
}

ZTEST(nvm, test_a_corrupt_mirror_copy_is_ignored)
{
	uint8_t payload[4];

	zassert_ok(nvm_write(&mirrored, a));
	zassert_ok(nvm_write(&mirrored, b));
	mirror_slot(1)[NVM_HEADER_LEN] ^= 0x01;
	zassert_ok(read_mirrored(payload));
	zassert_mem_equal(payload, b, 4, "FRAM's copy of b");
	zassert_true(nvm_mirror_available(), "one bad slot is not a failed mirror");
}

/* ---- Rings (DS-71's boot log) -------------------------------------------- */

static const struct nvm_region ring = {
	.name = "ring",
	.address = 0x400,
	.size = 4,
	.version = 1,
	.defaults = defaults,
	.ring = 4,
};

static uint8_t *ring_slot(int place)
{
	return &fake_fram_memory(fram)[ring.address + place * SLOT_SIZE];
}

ZTEST(nvm, test_a_ring_entry_goes_at_its_number)
{
	uint8_t payload[4];
	uint32_t number;

	zassert_ok(nvm_ring_write(&ring, 6, a));
	zassert_ok(nvm_ring_read(&ring, 2, payload, &number), "6 % 4 is place 2");
	zassert_equal(number, 6);
	zassert_mem_equal(payload, a, 4);
	zassert_equal(nvm_ring_read(&ring, 1, payload, &number), -ENOENT, "never written");
}

ZTEST(nvm, test_an_empty_ring_place_reads_as_the_default)
{
	struct nvm_boot_log entry = {.reset_cause = 99};
	uint32_t number = 99;

	/* The generated read fills the entry even when there is none. */
	zassert_equal(nvm_boot_log_read(5, &entry, &number), -ENOENT);
	zassert_equal(number, 0);
	zassert_equal(entry.reset_cause, 0, "the default from nvm_map.yaml");
}

ZTEST(nvm, test_a_ring_overwrites_the_oldest)
{
	uint8_t payload[4];
	uint32_t number;

	zassert_ok(nvm_ring_write(&ring, 1, a));
	zassert_ok(nvm_ring_write(&ring, 5, b), "four entries later, the same place");
	zassert_ok(nvm_ring_read(&ring, 1, payload, &number));
	zassert_equal(number, 5);
	zassert_mem_equal(payload, b, 4);
}

ZTEST(nvm, test_a_corrupt_ring_entry_reads_as_none)
{
	uint8_t payload[4];
	uint32_t number;
	uint32_t bad = nvm_stats().bad_slots;

	zassert_ok(nvm_ring_write(&ring, 3, a));
	ring_slot(3)[NVM_HEADER_LEN] ^= 0x01;
	zassert_equal(nvm_ring_read(&ring, 3, payload, &number), -ENOENT);
	zassert_equal(nvm_stats().bad_slots - bad, 1);
	zassert_true(nvm_available(), "one bad entry is not a failed part");
}

ZTEST(nvm, test_ring_limits)
{
	uint8_t payload[4];
	uint32_t number;

	zassert_equal(nvm_ring_read(&ring, 4, payload, &number), -EINVAL, "places 0 to 3");
	zassert_equal(nvm_ring_write(&region, 1, a), -EIO, "a two-slot record isn't a ring");
	fake_fram_fail(fram, true);
	zassert_equal(nvm_ring_write(&ring, 1, a), -EIO);
	zassert_equal(nvm_ring_read(&ring, 1, payload, &number), -EIO);
	zassert_false(nvm_available());
}

ZTEST(nvm, test_an_unmirrored_ring_never_touches_the_mirror)
{
	static const uint8_t blank[64];

	zassert_ok(nvm_ring_write(&ring, 1, a));
	zassert_mem_equal(fake_retained_mem_memory(mirror), blank, sizeof(blank));
}

/* The same ring, also kept in the mirror. */
static const struct nvm_region mirrored_ring = {
	.name = "mirrored_ring",
	.address = 0x500,
	.size = 4,
	.version = 1,
	.defaults = defaults,
	.mirrored = true,
	.mirror_address = 0x100,
	.ring = 4,
};

ZTEST(nvm, test_a_mirrored_ring_entry_is_written_to_both)
{
	const uint8_t *in_mirror =
		&fake_retained_mem_memory(mirror)[mirrored_ring.mirror_address + 2 * SLOT_SIZE];

	zassert_ok(nvm_ring_write(&mirrored_ring, 6, a));
	zassert_mem_equal(&fake_fram_memory(fram)[mirrored_ring.address + 2 * SLOT_SIZE +
						  NVM_HEADER_LEN],
			  a, 4);
	zassert_mem_equal(&in_mirror[NVM_HEADER_LEN], a, 4, "place 2 in the mirror too");
	zassert_equal(sys_get_le32(&in_mirror[4]), 6, "the entry's number");
}

ZTEST(nvm, test_the_mirror_keeps_the_ring_without_fram)
{
	uint8_t payload[4];
	uint32_t number;

	uint32_t from_mirror = nvm_stats().from_mirror;

	/* Like the Nucleo before its FRAM part: FRAM never works. */
	fake_fram_fail(fram, true);
	(void)nvm_retry();
	zassert_ok(nvm_ring_write(&mirrored_ring, 3, b));
	zassert_ok(nvm_ring_read(&mirrored_ring, 3, payload, &number));
	zassert_equal(nvm_stats().from_mirror - from_mirror, 1);
	zassert_equal(number, 3);
	zassert_mem_equal(payload, b, 4);
}

ZTEST(nvm, test_the_newer_ring_entry_wins_after_fram_returns)
{
	uint8_t payload[4];
	uint32_t number;

	/* Entry 1 reaches both; FRAM fails; entry 5, at the same place, reaches the mirror only. */
	zassert_ok(nvm_ring_write(&mirrored_ring, 1, a));
	fake_fram_fail(fram, true);
	zassert_ok(nvm_ring_write(&mirrored_ring, 5, b));

	/* FRAM works again, still holding entry 1 there: the mirror's 5 is newer. */
	fake_fram_fail(fram, false);
	zassert_ok(nvm_retry());
	zassert_ok(nvm_ring_read(&mirrored_ring, 1, payload, &number));
	zassert_equal(number, 5);
	zassert_mem_equal(payload, b, 4);
}

ZTEST(nvm, test_a_mirrored_ring_with_neither_store)
{
	uint8_t payload[4];
	uint32_t number;

	fake_fram_fail(fram, true);
	fake_retained_mem_fail(mirror, true);
	zassert_equal(nvm_ring_write(&mirrored_ring, 1, a), -EIO);
	zassert_equal(nvm_ring_read(&mirrored_ring, 1, payload, &number), -EIO);
}

/* ---- A generated record (nvm/command_ingest.h) ------------------------- */

ZTEST(nvm, test_generated_record_round_trip)
{
	struct nvm_command_state state;
	const struct nvm_command_state written = {
		.floor_slot0 = 0x0123456789abcdefULL,
		.floor_slot1 = UINT64_MAX,
		.active_slot = 1,
		.contacted = true,
		.last_accepted_met_ms = -2,
	};

	/* Blank FRAM: the defaults from nvm_map.yaml. */
	zassert_equal(nvm_command_state_read(&state), -ENOENT);
	zassert_equal(state.floor_slot0, 1767225600000ULL, "the mission epoch");
	zassert_equal(state.floor_slot1, 1767225600000ULL);
	zassert_equal(state.active_slot, 0);
	zassert_false(state.contacted);

	zassert_ok(nvm_command_state_write(&written));
	zassert_ok(nvm_command_state_read(&state));
	zassert_equal(state.floor_slot0, written.floor_slot0);
	zassert_equal(state.floor_slot1, written.floor_slot1);
	zassert_equal(state.active_slot, 1);
	zassert_true(state.contacted);
	zassert_equal(state.last_accepted_met_ms, -2);
}

/* ---- An image of FRAM from the ground (nvm_vectors.yaml) --------------- */

/*
 * tools/nvm_dump.py laid this image out, slots, generations and CRCs, the
 * way the FRAM service should. Reading it back with the generated readers
 * checks the ground and the satellite agree on every byte (DS-74).
 */
ZTEST(nvm, test_the_ground_image_reads_back)
{
	struct nvm_command_state state;
	struct nvm_run_checkpoint checkpoint;
	const struct nvm_command_state *want = &nvm_vector_command_state;

	memcpy(fake_fram_memory(fram), nvm_vector_image, sizeof(nvm_vector_image));

	zassert_ok(nvm_command_state_read(&state));
	zassert_equal(state.floor_slot0, want->floor_slot0);
	zassert_equal(state.floor_slot1, want->floor_slot1);
	zassert_equal(state.active_slot, want->active_slot);
	zassert_equal(state.contacted, want->contacted);
	zassert_equal(state.last_accepted_met_ms, want->last_accepted_met_ms);

	zassert_ok(nvm_run_checkpoint_read(&checkpoint));
	zassert_equal(checkpoint.boot_number, nvm_vector_run_checkpoint.boot_number);
	zassert_equal(checkpoint.met_ms, nvm_vector_run_checkpoint.met_ms);
	zassert_equal(checkpoint.uptime_ms, nvm_vector_run_checkpoint.uptime_ms);
	zassert_equal(checkpoint.reset_app, nvm_vector_run_checkpoint.reset_app);

	for (size_t i = 0; i < ARRAY_SIZE(nvm_vector_boot_log); i++) {
		struct nvm_boot_log entry;
		const struct nvm_boot_log *expected = &nvm_vector_boot_log[i].entry;
		uint32_t number;

		zassert_ok(nvm_boot_log_read(nvm_vector_boot_log[i].number % 16, &entry, &number));
		zassert_equal(number, nvm_vector_boot_log[i].number);
		zassert_equal(entry.reset_cause, expected->reset_cause);
		zassert_equal(entry.previous_run_ms, expected->previous_run_ms);
		zassert_equal(entry.met_at_boot_ms, expected->met_at_boot_ms);
		zassert_equal(entry.reset_app, expected->reset_app);
	}
}

/* ---- nvm_check and nvm_raw_read, for the nvm app (DS-74) --------------- */

ZTEST(nvm, test_check_counts_bad_slots)
{
	zassert_equal(nvm_check(&region), 0, "blank slots aren't bad");
	zassert_ok(nvm_write(&region, a));
	zassert_ok(nvm_write(&region, b));
	zassert_equal(nvm_check(&region), 0);
	slot(1)[NVM_HEADER_LEN] ^= 0x01;
	zassert_equal(nvm_check(&region), 1);
	slot(0)[NVM_HEADER_LEN] ^= 0x01;
	zassert_equal(nvm_check(&region), 2);
}

ZTEST(nvm, test_check_counts_both_stores)
{
	zassert_ok(nvm_write(&mirrored, a));
	zassert_equal(nvm_check(&mirrored), 0);
	fake_retained_mem_memory(mirror)[mirrored.mirror_address + NVM_HEADER_LEN] ^= 0x01;
	zassert_equal(nvm_check(&mirrored), 1, "the mirror's copy");
	fake_fram_memory(fram)[mirrored.address + NVM_HEADER_LEN] ^= 0x01;
	zassert_equal(nvm_check(&mirrored), 2, "and FRAM's");
}

ZTEST(nvm, test_check_reads_and_never_writes)
{
	uint8_t before[2 * SLOT_SIZE];

	zassert_ok(nvm_write(&region, a));
	slot(0)[NVM_HEADER_LEN] ^= 0x01;
	memcpy(before, slot(0), sizeof(before));
	zassert_equal(nvm_check(&region), 1);
	zassert_mem_equal(slot(0), before, sizeof(before), "a check repairs nothing");
}

ZTEST(nvm, test_check_a_ring)
{
	zassert_ok(nvm_ring_write(&ring, 3, a));
	zassert_equal(nvm_check(&ring), 0);
	fake_fram_memory(fram)[ring.address + 3 * SLOT_SIZE + NVM_HEADER_LEN] ^= 0x01;
	zassert_equal(nvm_check(&ring), 1);
}

ZTEST(nvm, test_check_with_fram_failed)
{
	fake_fram_fail(fram, true);
	zassert_equal(nvm_check(&region), -EIO);
	zassert_false(nvm_available());
}

ZTEST(nvm, test_raw_read)
{
	uint8_t buf[SLOT_SIZE];

	zassert_ok(nvm_write(&mirrored, a));
	zassert_ok(nvm_raw_read(NVM_STORE_FRAM, mirrored.address, buf, sizeof(buf)));
	zassert_mem_equal(buf, &fake_fram_memory(fram)[mirrored.address], sizeof(buf));
	zassert_ok(nvm_raw_read(NVM_STORE_MIRROR, mirrored.mirror_address, buf, sizeof(buf)));
	zassert_mem_equal(buf, &fake_retained_mem_memory(mirror)[mirrored.mirror_address],
			  sizeof(buf));
}

ZTEST(nvm, test_raw_read_limits)
{
	uint8_t buf[16];
	size_t fram_size = DT_PROP(FRAM_NODE, size);

	zassert_ok(nvm_raw_read(NVM_STORE_FRAM, fram_size - 16, buf, 16), "the last bytes");
	zassert_equal(nvm_raw_read(NVM_STORE_FRAM, fram_size - 15, buf, 16), -EINVAL);
	zassert_equal(nvm_raw_read(NVM_STORE_MIRROR, DT_PROP(NVM_MIRROR_NODE, size) - 15, buf, 16),
		      -EINVAL);
	zassert_equal(nvm_raw_read(2, 0, buf, 16), -EINVAL, "no such store");
	zassert_true(nvm_available(), "a bad request is not a fault");
}

ZTEST(nvm, test_raw_read_with_a_store_failed)
{
	uint8_t buf[16];

	fake_fram_fail(fram, true);
	zassert_equal(nvm_raw_read(NVM_STORE_FRAM, 0, buf, 16), -EIO);
	zassert_false(nvm_available());
	fake_fram_fail(fram, false);
	zassert_equal(nvm_raw_read(NVM_STORE_FRAM, 0, buf, 16), -EIO,
		      "degraded: not used again until a retry");
	zassert_ok(nvm_retry());
	zassert_ok(nvm_raw_read(NVM_STORE_FRAM, 0, buf, 16));
	fake_fram_fail(fram, true);
	zassert_ok(nvm_raw_read(NVM_STORE_MIRROR, 0, buf, 16), "the mirror still answers");
	fake_retained_mem_fail(mirror, true);
	zassert_equal(nvm_raw_read(NVM_STORE_MIRROR, 0, buf, 16), -EIO);
}
```

## src/route.c
```c
/*
 * Tests for command routing: decoding command text and publishing it to
 * the target app (DS-50 stages 6 and 7).
 *
 * SPDX-License-Identifier: Apache-2.0
 *
 * The vectors are shared with the ground's tests
 * (tools/tests/test_command_text.py), so both sides must give each one the
 * same result.
 */

#include <string.h>

#include <zephyr/kernel.h>
#include <zephyr/zbus/zbus.h>
#include <zephyr/ztest.h>

#include "msg/common.h"
#include "msg/typed_app.h"
#include "route_vectors.h"
#include "silversat/cmd_route.h"
#include "silversat/resource_map.h"

/* Stands in for typed_app, so tests can see what was published. */
ZBUS_MSG_SUBSCRIBER_DEFINE(typed_sub);
ZBUS_CHAN_ADD_OBS(typed_app_cmd_chan, typed_sub, 3);

static enum cmd_route_result route(const char *text, uint8_t mode, struct cmd_route_info *info)
{
	return cmd_route(text, strlen(text), mode, info);
}

/*
 * Report commands as handled on an app's status channel, as the app would.
 * Routing counts each app's unhandled ground commands (CMD_ROUTE_BUSY).
 */
static struct app_status typed_status;
static struct app_status frame_manager_status;

static void typed_handled(uint32_t count)
{
	typed_status.cmd_accepted += count;
	zassert_ok(zbus_chan_pub(&typed_app_status_chan, &typed_status, K_NO_WAIT));
}

/* Nothing reads the frame manager's commands here; just count them handled. */
static void frame_manager_handled(void)
{
	frame_manager_status.cmd_accepted++;
	zassert_ok(zbus_chan_pub(&frame_manager_status_chan, &frame_manager_status, K_NO_WAIT));
}

/* Take the next command typed_app was sent, or fail. */
static struct typed_app_cmd next_typed_command(void)
{
	const struct zbus_channel *chan;
	union typed_app_msg msg;

	zassert_ok(zbus_sub_wait_msg(&typed_sub, &chan, &msg, K_NO_WAIT), "nothing published");
	zassert_equal_ptr(chan, &typed_app_cmd_chan);
	typed_handled(1);
	return msg.cmd;
}

/* Handle everything waiting for typed_app. */
static void drain(void *fixture)
{
	const struct zbus_channel *chan;
	union typed_app_msg msg;
	uint32_t count = 0;

	ARG_UNUSED(fixture);
	while (zbus_sub_wait_msg(&typed_sub, &chan, &msg, K_NO_WAIT) == 0) {
		count++;
	}
	typed_handled(count);
}

ZTEST_SUITE(cmd_route, NULL, NULL, drain, drain, NULL);

ZTEST(cmd_route, test_shared_vectors)
{
	for (size_t i = 0; i < ARRAY_SIZE(route_vectors); i++) {
		const struct route_vector *v = &route_vectors[i];
		struct cmd_route_info info;
		enum cmd_route_result result = route(v->text, v->mode, &info);

		zassert_equal(result, v->result, "\"%s\": got %d, expected %d", v->text, result,
			      v->result);
		if (v->result == CMD_ROUTE_BAD_ARG) {
			zassert_equal(info.bad_arg, v->bad_arg, "\"%s\": argument %u", v->text,
				      info.bad_arg);
		}
		if (result == CMD_ROUTE_OK && info.app == APP_ID_FRAME_MANAGER) {
			frame_manager_handled();
		}
		drain(NULL);
	}
}

ZTEST(cmd_route, test_every_kind_at_its_limits)
{
	struct cmd_route_info info;
	struct typed_app_cmd cmd;

	zassert_equal(route("typed_app set_all 255 65535 4294967295 18446744073709551615 "
			    "127 32767 2147483647 9223372036854775807 true nominal",
			    MODE_SAFE, &info),
		      CMD_ROUTE_OK);
	cmd = next_typed_command();
	zassert_equal(cmd.id, TYPED_APP_CMD_SET_ALL);
	zassert_equal(cmd.args.set_all.u8, UINT8_MAX);
	zassert_equal(cmd.args.set_all.u16, UINT16_MAX);
	zassert_equal(cmd.args.set_all.u32, UINT32_MAX);
	zassert_equal(cmd.args.set_all.u64, UINT64_MAX);
	zassert_equal(cmd.args.set_all.i8, INT8_MAX);
	zassert_equal(cmd.args.set_all.i16, INT16_MAX);
	zassert_equal(cmd.args.set_all.i32, INT32_MAX);
	zassert_equal(cmd.args.set_all.i64, INT64_MAX);
	zassert_true(cmd.args.set_all.flag);
	zassert_equal(cmd.args.set_all.mode, MODE_NOMINAL);

	zassert_equal(route("typed_app set_all 0 0 0 0 -128 -32768 -2147483648 "
			    "-9223372036854775808 false safe",
			    MODE_NOMINAL, &info),
		      CMD_ROUTE_OK);
	cmd = next_typed_command();
	zassert_equal(cmd.args.set_all.u8, 0);
	zassert_equal(cmd.args.set_all.u64, 0);
	zassert_equal(cmd.args.set_all.i8, INT8_MIN);
	zassert_equal(cmd.args.set_all.i16, INT16_MIN);
	zassert_equal(cmd.args.set_all.i32, INT32_MIN);
	zassert_equal(cmd.args.set_all.i64, INT64_MIN);
	zassert_false(cmd.args.set_all.flag);
	zassert_equal(cmd.args.set_all.mode, MODE_SAFE);
}

ZTEST(cmd_route, test_info_names_the_target)
{
	struct cmd_route_info info;

	zassert_equal(route("typed_app nominal_only 7", MODE_NOMINAL, &info), CMD_ROUTE_OK);
	zassert_equal(info.app, APP_ID_TYPED_APP);
	zassert_equal(info.command, TYPED_APP_CMD_NOMINAL_ONLY);
	zassert_equal(next_typed_command().args.nominal_only.level, 7);

	/* Known app and command, but not allowed in safe mode. */
	zassert_equal(route("typed_app nominal_only 7", MODE_SAFE, &info), CMD_ROUTE_MODE);
	zassert_equal(info.app, APP_ID_TYPED_APP);
	zassert_equal(info.command, TYPED_APP_CMD_NOMINAL_ONLY);

	/* Known app, unknown command. */
	zassert_equal(route("typed_app pong", MODE_SAFE, &info), CMD_ROUTE_UNKNOWN_COMMAND);
	zassert_equal(info.app, APP_ID_TYPED_APP);
	zassert_equal(info.command, 0);

	zassert_equal(route("no_such_app ping", MODE_SAFE, &info), CMD_ROUTE_UNKNOWN_APP);
	zassert_equal(info.app, 0);
}

ZTEST(cmd_route, test_rejected_commands_are_not_published)
{
	const struct zbus_channel *chan;
	union typed_app_msg msg;
	struct cmd_route_info info;

	zassert_equal(route("typed_app nominal_only 7", MODE_SAFE, &info), CMD_ROUTE_MODE);
	zassert_equal(route("typed_app nominal_only 256", MODE_NOMINAL, &info), CMD_ROUTE_BAD_ARG);
	zassert_equal(route("typed_app ping extra", MODE_SAFE, &info), CMD_ROUTE_BAD_ARG_COUNT);
	zassert_equal(zbus_sub_wait_msg(&typed_sub, &chan, &msg, K_NO_WAIT), -ENOMSG);
}

ZTEST(cmd_route, test_unknown_mode)
{
	struct cmd_route_info info;

	zassert_equal(route("typed_app ping", MODE_MAX + 1, &info), CMD_ROUTE_MODE);
}

ZTEST(cmd_route, test_busy_app)
{
	/*
	 * typed_app stops handling commands. Once CMD_MAX_PENDING are waiting,
	 * the next is refused rather than queued, so the zbus pool stays within
	 * its budget (DS-07).
	 */
	struct cmd_route_info info;

	for (int i = 0; i < CMD_MAX_PENDING; i++) {
		zassert_equal(route("typed_app ping", MODE_SAFE, &info), CMD_ROUTE_OK);
	}
	zassert_equal(route("typed_app ping", MODE_SAFE, &info), CMD_ROUTE_BUSY);
	zassert_equal(info.app, APP_ID_TYPED_APP);
	zassert_equal(info.command, TYPED_APP_CMD_PING);

	/* Another app is unaffected. */
	zassert_equal(route("frame_manager set_entry_enabled safe 0 true", MODE_SAFE, &info),
		      CMD_ROUTE_OK);
	frame_manager_handled();

	/* Once typed_app catches up, it can be sent commands again. */
	drain(NULL);
	zassert_equal(route("typed_app ping", MODE_SAFE, &info), CMD_ROUTE_OK);
}

ZTEST(cmd_route, test_publish_failure_is_reported)
{
	/*
	 * Here typed_app reports each command handled without taking it from
	 * its queue, so the busy check passes but every accepted command still
	 * holds a zbus buffer. Once the pool is down to the buffer each publish
	 * needs for itself, the copy for typed_sub cannot be made and the
	 * publish fails.
	 */
	struct cmd_route_info info;
	int accepted = 0;

	while (route("typed_app ping", MODE_SAFE, &info) == CMD_ROUTE_OK) {
		typed_handled(1);
		accepted++;
		zassert_true(accepted < CONFIG_ZBUS_MSG_SUBSCRIBER_NET_BUF_POOL_SIZE, "never failed");
	}
	zassert_equal(route("typed_app ping", MODE_SAFE, &info), CMD_ROUTE_PUBLISH_FAILED);
	zassert_equal(accepted, CONFIG_ZBUS_MSG_SUBSCRIBER_NET_BUF_POOL_SIZE - 1);
}
```

## src/tlm_encode.c
```c
/*
 * Tests for the generated housekeeping and event encoders (DS-10, DS-61,
 * DS-64).
 *
 * SPDX-License-Identifier: Apache-2.0
 *
 * The vectors come from the ground decoder, tools/telemetry.py, at build
 * time: the flight encoder must produce exactly the bytes the ground
 * expects.
 */

#include <errno.h>

#include <zephyr/zbus/zbus.h>
#include <zephyr/ztest.h>

#include "msg/common.h"
#include "msg/typed_app.h"
#include "silversat/tlm_encode.h"
#include "tlm_vectors.h"

ZTEST(tlm_encode, test_encoding_matches_the_ground)
{
	for (size_t i = 0; i < ARRAY_SIZE(hk_vectors); i++) {
		const struct hk_vector *v = &hk_vectors[i];
		uint8_t out[255];
		int len;

		zassert_ok(zbus_chan_pub(&typed_app_hk_chan, v->hk, K_NO_WAIT));
		len = tlm_encode_hk(APP_ID_TYPED_APP, v->met_ms, out, sizeof(out));
		zassert_equal(len, (int)v->len, "%s: length %d", v->name, len);
		zassert_mem_equal(out, v->packet, v->len, "%s: bytes", v->name);
	}
}

ZTEST(tlm_encode, test_event_encoding_matches_the_ground)
{
	for (size_t i = 0; i < ARRAY_SIZE(event_vectors); i++) {
		const struct event_vector *v = &event_vectors[i];
		uint8_t out[255];
		int len = tlm_encode_event(v->event, out, sizeof(out));

		zassert_equal(len, (int)v->len, "%s: length %d", v->name, len);
		zassert_mem_equal(out, v->packet, v->len, "%s: bytes", v->name);
		zassert_equal(out[0], TLM_KIND_EVENT);
	}
}

ZTEST(tlm_encode, test_an_event_needs_room)
{
	uint8_t out[255];
	size_t len = event_vectors[0].len;

	zassert_equal(tlm_encode_event(event_vectors[0].event, out, len - 1), -ENOSPC);
	zassert_equal(tlm_encode_event(event_vectors[0].event, out, len), (int)len);
}

ZTEST(tlm_encode, test_every_app_is_listed_once)
{
	for (size_t i = 0; i < tlm_hk_app_count; i++) {
		for (size_t j = i + 1; j < tlm_hk_app_count; j++) {
			zassert_not_equal(tlm_hk_apps[i], tlm_hk_apps[j]);
		}
	}
	zassert_equal(tlm_hk_app_count, APP_COUNT);
}

ZTEST(tlm_encode, test_every_app_encodes)
{
	uint8_t out[255];

	for (size_t i = 0; i < tlm_hk_app_count; i++) {
		int len = tlm_encode_hk(tlm_hk_apps[i], 7, out, sizeof(out));

		zassert_true(len >= TLM_HK_HEADER_LEN, "app %u: %d", tlm_hk_apps[i], len);
		zassert_equal(out[0], TLM_KIND_HK);
		zassert_equal(out[1], tlm_hk_apps[i]);
		zassert_equal(out[2], 7, "MET, least significant byte first");
	}
}

ZTEST(tlm_encode, test_unknown_app)
{
	uint8_t out[255];

	zassert_equal(tlm_encode_hk(0, 0, out, sizeof(out)), -ENOENT);
}

ZTEST(tlm_encode, test_needs_room)
{
	uint8_t out[255];
	size_t full = (size_t)tlm_encode_hk(APP_ID_TYPED_APP, 0, out, sizeof(out));

	zassert_equal(tlm_encode_hk(APP_ID_TYPED_APP, 0, out, full - 1), -ENOSPC);
	zassert_equal(tlm_encode_hk(APP_ID_TYPED_APP, 0, out, full), (int)full);
}

ZTEST_SUITE(tlm_encode, NULL, NULL, NULL, NULL, NULL);
```
