## CMakeLists.txt
```
cmake_minimum_required(VERSION 3.20.0)

# The fake FRAM's and mirror's bindings (app.overlay).
set(FAKES ${CMAKE_CURRENT_SOURCE_DIR}/../../fakes)
list(APPEND DTS_ROOT ${FAKES})

find_package(Zephyr REQUIRED HINTS $ENV{ZEPHYR_BASE})
project(mode_manager_test LANGUAGES C)

target_sources(app PRIVATE src/main.c ../common/app_test.c ${FAKES}/fake_fram.c
  ${FAKES}/fake_retained_mem.c)
target_include_directories(app PRIVATE ../common ${FAKES})
```

## prj.conf
```kconfig
CONFIG_ZTEST=y

CONFIG_SS_MESSAGES=y
CONFIG_SS_MODE_MANAGER=y
```

## app.overlay
```dts
/*
 * The test signal (DS-42) is an emulated GPIO pin, active high, so it reads
 * absent until a test drives it.
 */

/ {
	aliases {
		test-mode-signal = &test_mode_signal;
	};

	test_mode_signal: test-mode-signal {
		compatible = "silversat,test-mode-signal";
		gpios = <&gpio0 1 GPIO_ACTIVE_HIGH>;
	};
};
```

## src/main.c
```c
/*
 * Mode manager tests (DS-40, DS-41, DS-42, DS-46).
 *
 * SPDX-License-Identifier: Apache-2.0
 *
 * The mode manager runs as it does in flight. The tests stand in for:
 *   - the frame manager: they wake it with ticks whose MET they choose, so
 *     a week passes in one call;
 *   - command ingest: they publish ground_contact_chan, as if a command had
 *     been accepted, and send set_mode on the command channel;
 *   - health: they send request_mode, as another app would (DS-40);
 *   - the radio: they receive its command channel, and count commands
 *     handled on its status channel only when a test says so.
 */

#include <errno.h>

#include <zephyr/drivers/gpio.h>
#include <zephyr/drivers/gpio/gpio_emul.h>
#include <zephyr/kernel.h>
#include <zephyr/zbus/zbus.h>
#include <zephyr/ztest.h>

#include "app_test.h"
#include "msg/common.h"
#include "msg/mode_manager.h"
#include "msg/radio.h"
#include "nvm/mode_manager.h"
#include "silversat/event.h"
#include "silversat/resource_map.h"

#define WAIT K_SECONDS(1)

#define HOUR_MS (60LL * 60 * 1000)
#define TIMEOUT_MS (CONFIG_SS_COMMAND_LOSS_TIMEOUT_HOURS * HOUR_MS)
#define SEPARATION_MS (CONFIG_SS_SEPARATION_DELAY_MINUTES * 60LL * 1000)

/* The test signal, an emulated pin (app.overlay). It starts absent. */
static const struct gpio_dt_spec test_signal = GPIO_DT_SPEC_GET(TEST_SIGNAL_NODE, gpios);

/* ---- Standing in for the radio ----------------------------------------- */

ZBUS_MSG_SUBSCRIBER_DEFINE(radio_sub);
ZBUS_CHAN_ADD_OBS(radio_cmd_chan, radio_sub, 3);

static struct app_status radio_status;

/*
 * The next command the mode manager sent the radio, if any. Counts it as
 * handled only if handle is true; otherwise it stays pending, as if the
 * radio had stalled.
 */
static bool radio_next(struct radio_cmd *cmd, bool handle)
{
	const struct zbus_channel *chan;
	union radio_msg msg;

	if (zbus_sub_wait_msg(&radio_sub, &chan, &msg, K_NO_WAIT) != 0) {
		return false;
	}
	*cmd = msg.cmd;
	if (handle) {
		radio_status.cmd_accepted++;
		zassert_ok(zbus_chan_pub(&radio_status_chan, &radio_status, K_NO_WAIT));
	}
	return true;
}

/* The radio catches up on everything it was sent but didn't handle. */
static void radio_catch_up(uint32_t unhandled)
{
	struct radio_cmd cmd;

	while (radio_next(&cmd, true)) {
	}
	radio_status.cmd_accepted += unhandled;
	zassert_ok(zbus_chan_pub(&radio_status_chan, &radio_status, K_NO_WAIT));
}

/* ---- Standing in for the frame manager and command ingest -------------- */

static uint32_t frame_count;

/* Wake the mode manager once, as the frame manager would, at this MET. */
static void wake_at(int64_t met_ms)
{
	struct frame_tick tick = app_test_tick(frame_count++);
	struct app_status before;

	tick.met_ms = met_ms;
	zassert_ok(zbus_chan_read(&mode_manager_status_chan, &before, K_MSEC(10)));
	zassert_ok(zbus_chan_pub(&mode_manager_wakeup_chan, &tick, K_NO_WAIT));
	zassert_ok(app_test_wait_status(&mode_manager_status_chan, before.steps + 1, 0, WAIT,
					NULL));
}

/* Command ingest accepted a command at this MET. */
static void contact_at(int64_t met_ms)
{
	const struct ground_contact contact = {.contacted = true, .last_accepted_met_ms = met_ms};

	zassert_ok(zbus_chan_pub(&ground_contact_chan, &contact, K_NO_WAIT));
}

/* Send one command and wait for it. Returns 1 if accepted, 0 if rejected. */
static int command(const struct mode_manager_cmd *cmd)
{
	struct app_status before;
	struct app_status after;

	zassert_ok(zbus_chan_read(&mode_manager_status_chan, &before, K_MSEC(10)));
	zassert_ok(zbus_chan_pub(&mode_manager_cmd_chan, cmd, K_NO_WAIT));
	zassert_ok(app_test_wait_status(&mode_manager_status_chan, 0,
					before.cmd_accepted + before.cmd_rejected + 1, WAIT,
					&after));
	return (int)(after.cmd_accepted - before.cmd_accepted);
}

static int set_mode(uint8_t mode)
{
	const struct mode_manager_cmd cmd = {
		.id = MODE_MANAGER_CMD_SET_MODE,
		.args.set_mode = {.mode = mode},
	};

	return command(&cmd);
}

/* Another app's request (DS-40). Returns 1 if accepted, 0 if refused. */
static int request(uint8_t mode, uint8_t reason)
{
	const struct mode_manager_cmd cmd = {
		.id = MODE_MANAGER_CMD_REQUEST_MODE,
		.args.request_mode = {.mode = mode, .reason = reason},
	};

	return command(&cmd);
}

static struct mode_state mode_now(void)
{
	struct mode_state state;

	zassert_ok(zbus_chan_read(&mode_chan, &state, K_MSEC(10)));
	return state;
}

static struct mode_manager_hk mm_hk(void)
{
	struct mode_manager_hk hk;

	zassert_ok(zbus_chan_read(&mode_manager_hk_chan, &hk, K_MSEC(10)));
	return hk;
}

/* The mode manager should have raised this event, with these arguments. */
static void expect_event(uint16_t id, int32_t mode, int32_t reason)
{
	struct event event;

	zassert_true(app_test_find_event(APP_ID_MODE_MANAGER, id, &event), "event %u", id);
	zassert_equal(event.arg0, mode);
	zassert_equal(event.arg1, reason);
}

/*
 * Each test gets its own stretch of mission time, far from every other
 * test's, so a contact or a silence from one test can't reach the next.
 */
static int64_t epoch;

/*
 * What happened between boot and safe mode, recorded once by setup() and
 * checked by the test_boot_* tests. A boot happens only once per run, so
 * the tests can't each repeat it.
 */
static struct {
	struct mode_state at_boot;
	int ground_set_safe_in_deploy;
	int reset_loop_in_deploy;
	int claimed_deployment;
	int claimed_test_signal;
	uint8_t after_requests_in_deploy;
	uint8_t after_first_wakeup;
	uint8_t after_late_signal;
	uint8_t just_before_delay;
	struct mode_state at_delay;
} boot;

static void *setup(void)
{
	/* Let the mode manager's thread start. */
	k_sleep(K_MSEC(10));
	boot.at_boot = mode_now();
	boot.ground_set_safe_in_deploy = set_mode(MODE_SAFE);
	boot.reset_loop_in_deploy = request(MODE_SAFE, MODE_REASON_RESET_LOOP);
	boot.claimed_deployment = request(MODE_SAFE, MODE_REASON_DEPLOYMENT_COMPLETE);
	boot.claimed_test_signal = request(MODE_TEST, MODE_REASON_TEST_SIGNAL);
	boot.after_requests_in_deploy = mode_now().mode;

	/* The first wakeup reads the test signal, absent here. */
	wake_at(1000);
	boot.after_first_wakeup = mode_now().mode;

	/* The signal appearing later must change nothing. */
	zassert_ok(gpio_emul_input_set(test_signal.port, test_signal.pin, 1));
	wake_at(2000);
	boot.after_late_signal = mode_now().mode;
	zassert_ok(gpio_emul_input_set(test_signal.port, test_signal.pin, 0));

	wake_at(SEPARATION_MS - 1);
	boot.just_before_delay = mode_now().mode;
	wake_at(SEPARATION_MS);
	boot.at_delay = mode_now();
	return NULL;
}

/*
 * Each test starts in safe mode, with the radio caught up and no contact
 * with the ground, so an earlier test's contact can't fire the timer.
 */
static void before(void *fixture)
{
	const struct ground_contact never = {0};

	ARG_UNUSED(fixture);
	epoch += 1000 * 24 * HOUR_MS;
	zassert_ok(zbus_chan_pub(&ground_contact_chan, &never, K_NO_WAIT));
	zassert_equal(set_mode(MODE_SAFE), 1);
	radio_catch_up(0);
	app_test_drain_events();
}

ZTEST_SUITE(mode_manager, NULL, setup, before, NULL, NULL);

/* ---- Boot: deploy, then safe (DS-42) ------------------------------------- */

ZTEST(mode_manager, test_boot_starts_in_deploy)
{
	zassert_equal(boot.at_boot.mode, MODE_DEPLOY);
	zassert_equal(boot.at_boot.reason, MODE_REASON_BOOT);
	zassert_equal(boot.ground_set_safe_in_deploy, 0, "no ground command ends deploy early");
}

ZTEST(mode_manager, test_boot_a_request_cannot_end_deploy_early)
{
	/* Only the separation delay ends deploy mode (DS-42), not even a reset loop. */
	zassert_equal(boot.reset_loop_in_deploy, 0);
	/* And no app can claim the mode manager's own triggers. */
	zassert_equal(boot.claimed_deployment, 0);
	zassert_equal(boot.claimed_test_signal, 0);
	zassert_equal(boot.after_requests_in_deploy, MODE_DEPLOY);
}

ZTEST(mode_manager, test_boot_test_signal_is_read_only_at_boot)
{
	zassert_equal(boot.after_first_wakeup, MODE_DEPLOY, "no signal: no test mode");
	zassert_equal(boot.after_late_signal, MODE_DEPLOY,
		      "a signal after boot, a glitch in flight, is ignored");
}

ZTEST(mode_manager, test_boot_safe_after_the_separation_delay)
{
	zassert_equal(boot.just_before_delay, MODE_DEPLOY, "a millisecond early: still deploy");
	zassert_equal(boot.at_delay.mode, MODE_SAFE);
	zassert_equal(boot.at_delay.reason, MODE_REASON_DEPLOYMENT_COMPLETE);
	zassert_equal(boot.at_delay.since_met_ms, SEPARATION_MS);
}

ZTEST(mode_manager, test_nothing_leads_back_to_deploy_or_test)
{
	uint32_t refused = mm_hk().refused;

	zassert_equal(set_mode(MODE_DEPLOY), 0);
	zassert_equal(set_mode(MODE_TEST), 0);
	zassert_equal(set_mode(MODE_NOMINAL), 1);
	zassert_equal(set_mode(MODE_DEPLOY), 0);
	zassert_equal(set_mode(MODE_TEST), 0);
	zassert_equal(mm_hk().refused - refused, 4);
}

/* ---- Ground commands and the transition table --------------------------- */

ZTEST(mode_manager, test_ground_sets_nominal_and_safe)
{
	uint32_t transitions = mm_hk().transitions;
	struct mode_state state;

	wake_at(epoch + 5000);
	zassert_equal(set_mode(MODE_NOMINAL), 1);
	state = mode_now();
	zassert_equal(state.mode, MODE_NOMINAL);
	zassert_equal(state.reason, MODE_REASON_GROUND_COMMAND);
	zassert_equal(state.since_met_ms, epoch + 5000, "timed from the latest tick (DS-25)");

	zassert_equal(set_mode(MODE_SAFE), 1);
	zassert_equal(mode_now().mode, MODE_SAFE);
	zassert_equal(mm_hk().transitions - transitions, 2);
	zassert_equal(mm_hk().mode, MODE_SAFE, "housekeeping follows at once (DS-14)");
}

ZTEST(mode_manager, test_setting_the_current_mode_changes_nothing)
{
	uint32_t transitions = mm_hk().transitions;
	struct mode_state state = mode_now();

	/* Sets, doesn't toggle (DS-35): accepted, and nothing happens. */
	zassert_equal(set_mode(MODE_SAFE), 1);
	zassert_equal(mm_hk().transitions, transitions);
	zassert_equal(mode_now().since_met_ms, state.since_met_ms);
}

ZTEST(mode_manager, test_unknown_mode_is_refused)
{
	uint32_t refused = mm_hk().refused;

	zassert_equal(set_mode(MODE_MAX + 1), 0);
	zassert_equal(mode_now().mode, MODE_SAFE);
	zassert_equal(mm_hk().refused - refused, 1);
}

ZTEST(mode_manager, test_unknown_command_is_rejected)
{
	const struct mode_manager_cmd cmd = {.id = 99};

	zassert_equal(command(&cmd), 0);
	zassert_equal(mode_now().mode, MODE_SAFE);
}

ZTEST(mode_manager, test_mode_is_published_every_major_frame)
{
	/*
	 * Republished each wakeup, so a publish that failed is repaired. Show
	 * it by overwriting mode_chan, as a failed publish would leave it.
	 */
	const struct mode_state wrong = {.mode = MODE_NOMINAL};

	zassert_ok(zbus_chan_pub(&mode_chan, &wrong, K_NO_WAIT));
	wake_at(epoch);
	zassert_equal(mode_now().mode, MODE_SAFE);
}

/* ---- Requests from other apps (DS-40, DS-41) ----------------------------- */

ZTEST(mode_manager, test_a_request_enters_safe_mode)
{
	struct mode_manager_hk start = mm_hk();
	struct nvm_mode_state stored;
	struct mode_state state;

	wake_at(epoch + 7000);
	zassert_equal(set_mode(MODE_NOMINAL), 1);
	zassert_equal(request(MODE_SAFE, MODE_REASON_RESET_LOOP), 1);
	state = mode_now();
	zassert_equal(state.mode, MODE_SAFE);
	zassert_equal(state.reason, MODE_REASON_RESET_LOOP);
	zassert_equal(state.since_met_ms, epoch + 7000);
	zassert_equal(mm_hk().requests - start.requests, 1);
	zassert_equal(mm_hk().transitions - start.transitions, 2, "to nominal, then to safe");
	zassert_ok(nvm_mode_state_read(&stored));
	zassert_equal(stored.reason, MODE_REASON_RESET_LOOP, "kept through a reset (DS-41)");
}

ZTEST(mode_manager, test_a_request_in_safe_mode_replaces_the_reason)
{
	struct mode_manager_hk start = mm_hk();
	struct mode_state before = mode_now();
	struct nvm_mode_state stored;

	zassert_not_equal(before.reason, MODE_REASON_APP_FAILURE);
	zassert_equal(request(MODE_SAFE, MODE_REASON_APP_FAILURE), 1);
	zassert_equal(mode_now().mode, MODE_SAFE);
	zassert_equal(mode_now().reason, MODE_REASON_APP_FAILURE, "the latest cause");
	zassert_equal(mode_now().since_met_ms, before.since_met_ms, "not a new entry");
	zassert_equal(mm_hk().reason, MODE_REASON_APP_FAILURE);
	zassert_equal(mm_hk().transitions, start.transitions, "no transition");
	zassert_equal(mm_hk().requests - start.requests, 1);
	zassert_ok(nvm_mode_state_read(&stored));
	zassert_equal(stored.reason, MODE_REASON_APP_FAILURE);

	/* The same cause again changes nothing. */
	zassert_equal(request(MODE_SAFE, MODE_REASON_APP_FAILURE), 1);
	zassert_equal(mm_hk().requests - start.requests, 1);

	/* Nor does a reason out of range, which would otherwise be stored as it is. */
	zassert_equal(request(MODE_SAFE, 32 + MODE_REASON_RESET_LOOP), 0);
	zassert_equal(mode_now().reason, MODE_REASON_APP_FAILURE);
}

ZTEST(mode_manager, test_a_request_for_another_current_mode_changes_nothing)
{
	struct mode_manager_hk start = mm_hk();

	/* Only safe mode's reason is replaced: elsewhere the reason is why the ground chose it. */
	zassert_equal(set_mode(MODE_NOMINAL), 1);
	zassert_equal(request(MODE_NOMINAL, MODE_REASON_LOW_BATTERY), 1);
	zassert_equal(mode_now().mode, MODE_NOMINAL);
	zassert_equal(mode_now().reason, MODE_REASON_GROUND_COMMAND);
	zassert_equal(mm_hk().requests, start.requests);
}

ZTEST(mode_manager, test_the_ground_setting_safe_keeps_the_reason)
{
	/* A ground set_mode for the current mode changes nothing (DS-35), not even the reason. */
	zassert_equal(request(MODE_SAFE, MODE_REASON_RESET_LOOP), 1);
	zassert_equal(set_mode(MODE_SAFE), 1);
	zassert_equal(mode_now().reason, MODE_REASON_RESET_LOOP);
}

ZTEST(mode_manager, test_a_request_cannot_leave_safe_mode)
{
	uint32_t refused = mm_hk().refused;

	/* Only the ground leaves safe mode (DS-41). */
	zassert_equal(request(MODE_NOMINAL, MODE_REASON_RESET_LOOP), 0);
	zassert_equal(mode_now().mode, MODE_SAFE);
	zassert_equal(mm_hk().refused - refused, 1);
}

ZTEST(mode_manager, test_a_request_cannot_speak_for_the_ground)
{
	struct mode_manager_hk start = mm_hk();

	zassert_equal(set_mode(MODE_NOMINAL), 1);
	zassert_equal(request(MODE_SAFE, MODE_REASON_GROUND_COMMAND), 0);
	zassert_equal(request(MODE_SAFE, MODE_REASON_BOOT), 0);
	zassert_equal(request(MODE_SAFE, MODE_REASON_MAX + 1), 0);
	zassert_equal(request(MODE_SAFE, 200), 0, "far past the reasons mask");
	zassert_equal(request(MODE_SAFE, 32 + MODE_REASON_RESET_LOOP), 0,
		      "past the mask, though its low bits name an allowed reason");
	zassert_equal(mode_now().mode, MODE_NOMINAL);
	zassert_equal(mm_hk().refused - start.refused, 5);
	zassert_equal(mm_hk().requests, start.requests);
}

ZTEST(mode_manager, test_a_request_cannot_claim_the_mode_managers_triggers)
{
	struct radio_cmd cmd;

	/* Command loss is the mode manager's own timer (DS-46). */
	zassert_equal(set_mode(MODE_NOMINAL), 1);
	zassert_equal(request(MODE_SAFE, MODE_REASON_COMMAND_LOSS), 0);
	zassert_equal(request(MODE_SAFE, MODE_REASON_DEPLOYMENT_COMPLETE), 0);
	zassert_equal(mode_now().mode, MODE_NOMINAL);
	zassert_false(radio_next(&cmd, true), "and none of its actions ran");
}

ZTEST(mode_manager, test_each_reason_another_app_may_give)
{
	const uint8_t reasons[] = {MODE_REASON_LOW_BATTERY, MODE_REASON_RESET_LOOP,
				   MODE_REASON_APP_FAILURE};

	for (size_t i = 0; i < ARRAY_SIZE(reasons); i++) {
		zassert_equal(set_mode(MODE_NOMINAL), 1);
		zassert_equal(request(MODE_SAFE, reasons[i]), 1, "reason %u", reasons[i]);
		zassert_equal(mode_now().reason, reasons[i]);
	}
}

/* ---- The command-loss timer (DS-46) -------------------------------------- */

ZTEST(mode_manager, test_no_timer_before_first_contact)
{
	/*
	 * No contact yet. The MET is new, so a timer that ignored "contacted"
	 * would treat it as a fresh silence and fire.
	 */
	const struct ground_contact not_yet = {.contacted = false, .last_accepted_met_ms = epoch};
	struct radio_cmd cmd;
	uint32_t fired = mm_hk().command_loss;

	zassert_ok(zbus_chan_pub(&ground_contact_chan, &not_yet, K_NO_WAIT));
	/* A year passes without contact. */
	wake_at(epoch + 365 * 24 * HOUR_MS);
	zassert_false(radio_next(&cmd, true), "keeps transmitting so the ground can find it");
	zassert_equal(mm_hk().command_loss, fired);
}

ZTEST(mode_manager, test_command_loss_silences_and_enters_safe)
{
	struct radio_cmd cmd;
	struct mode_state state;
	uint32_t fired = mm_hk().command_loss;

	zassert_equal(set_mode(MODE_NOMINAL), 1);
	contact_at(epoch);

	wake_at(epoch + TIMEOUT_MS - 1);
	zassert_false(radio_next(&cmd, true), "a millisecond early: nothing");
	zassert_equal(mode_now().mode, MODE_NOMINAL);

	wake_at(epoch + TIMEOUT_MS);
	zassert_true(radio_next(&cmd, true));
	zassert_equal(cmd.id, RADIO_CMD_SET_TRANSMIT);
	zassert_false(cmd.args.set_transmit.enabled);
	state = mode_now();
	zassert_equal(state.mode, MODE_SAFE);
	zassert_equal(state.reason, MODE_REASON_COMMAND_LOSS);
	zassert_equal(state.since_met_ms, epoch + TIMEOUT_MS);
	zassert_equal(mm_hk().command_loss - fired, 1);
}

ZTEST(mode_manager, test_command_loss_in_safe_mode_still_silences)
{
	struct radio_cmd cmd;

	struct mode_manager_hk start;
	struct nvm_mode_state stored;
	struct mode_state before;

	/*
	 * Already in safe mode, entered by the ground: no transition, but the
	 * action still runs, and command loss becomes the reason (DS-41).
	 */
	zassert_equal(set_mode(MODE_NOMINAL), 1);
	zassert_equal(set_mode(MODE_SAFE), 1);
	start = mm_hk();
	before = mode_now();
	contact_at(epoch);
	wake_at(epoch + TIMEOUT_MS);
	zassert_true(radio_next(&cmd, true));
	zassert_false(cmd.args.set_transmit.enabled);
	zassert_equal(mode_now().mode, MODE_SAFE);
	zassert_equal(mode_now().reason, MODE_REASON_COMMAND_LOSS, "the latest cause");
	zassert_equal(mode_now().since_met_ms, before.since_met_ms, "not a new entry");
	zassert_equal(mm_hk().transitions, start.transitions, "no transition");
	zassert_ok(nvm_mode_state_read(&stored));
	zassert_equal(stored.reason, MODE_REASON_COMMAND_LOSS, "kept through a reset");
}

ZTEST(mode_manager, test_command_loss_fires_once_per_silence)
{
	struct radio_cmd cmd;
	uint32_t fired = mm_hk().command_loss;

	contact_at(epoch);
	wake_at(epoch + TIMEOUT_MS);
	zassert_true(radio_next(&cmd, true));

	/* The silence goes on: no more commands. */
	wake_at(epoch + 2 * TIMEOUT_MS);
	zassert_false(radio_next(&cmd, true));

	/* The ground is heard again, then goes quiet again: it fires again. */
	contact_at(epoch + 3 * TIMEOUT_MS);
	wake_at(epoch + 3 * TIMEOUT_MS + 1);
	zassert_false(radio_next(&cmd, true), "contact re-arms the timer; it doesn't fire");
	wake_at(epoch + 4 * TIMEOUT_MS);
	zassert_true(radio_next(&cmd, true));
	zassert_equal(mm_hk().command_loss - fired, 2);
}

ZTEST(mode_manager, test_ground_can_leave_safe_after_command_loss)
{
	zassert_equal(set_mode(MODE_NOMINAL), 1);
	contact_at(epoch);
	wake_at(epoch + TIMEOUT_MS);
	zassert_equal(mode_now().mode, MODE_SAFE);

	/* Command loss can't take the spacecraft out of safe mode; the ground can. */
	contact_at(epoch + TIMEOUT_MS + 1000);
	zassert_equal(set_mode(MODE_NOMINAL), 1);
	zassert_equal(mode_now().mode, MODE_NOMINAL);
}

ZTEST(mode_manager, test_busy_radio_is_retried_next_major_frame)
{
	struct radio_cmd cmd;
	uint32_t failures = mm_hk().action_failures;

	/*
	 * The radio stops handling commands. Two silences fill the mode
	 * manager's CMD_MAX_PENDING to it; the third can't be sent.
	 */
	BUILD_ASSERT(CMD_MAX_PENDING == 2, "this test fills the pending count with two silences");
	for (int i = 0; i < CMD_MAX_PENDING; i++) {
		contact_at(epoch + i * 2 * TIMEOUT_MS);
		wake_at(epoch + i * 2 * TIMEOUT_MS + TIMEOUT_MS);
		zassert_true(radio_next(&cmd, false));
	}
	contact_at(epoch + 4 * TIMEOUT_MS);
	wake_at(epoch + 5 * TIMEOUT_MS);
	zassert_false(radio_next(&cmd, false), "the radio already has too many waiting");
	zassert_equal(mm_hk().action_failures - failures, 1);

	/* Still busy a major frame later: tried and counted again. */
	wake_at(epoch + 5 * TIMEOUT_MS + 1000);
	zassert_equal(mm_hk().action_failures - failures, 2);

	/* The radio catches up; the next major frame sends it. */
	radio_catch_up(CMD_MAX_PENDING);
	wake_at(epoch + 5 * TIMEOUT_MS + 2000);
	zassert_true(radio_next(&cmd, true));
	zassert_false(cmd.args.set_transmit.enabled);

	/* Sent: no more tries. */
	wake_at(epoch + 5 * TIMEOUT_MS + 3000);
	zassert_false(radio_next(&cmd, true));
	zassert_equal(mm_hk().action_failures - failures, 2);
}

/* ---- What the mode manager stores (DS-41, DS-42, DS-74) ----------------- */

ZTEST(mode_manager, test_the_end_of_deployment_is_stored)
{
	struct nvm_deployment deployment;

	/* setup() booted through deploy into safe mode. */
	zassert_ok(nvm_deployment_read(&deployment));
	zassert_true(deployment.complete, "later boots start in safe mode, not deploy");
}

ZTEST(mode_manager, test_every_mode_change_is_stored)
{
	struct nvm_mode_state stored;

	zassert_equal(set_mode(MODE_NOMINAL), 1);
	zassert_ok(nvm_mode_state_read(&stored));
	zassert_equal(stored.mode, MODE_NOMINAL);
	zassert_equal(stored.reason, MODE_REASON_GROUND_COMMAND);

	zassert_equal(set_mode(MODE_SAFE), 1);
	zassert_ok(nvm_mode_state_read(&stored));
	zassert_equal(stored.mode, MODE_SAFE);
}

/* ---- Events (DS-10) --------------------------------------------------------- */

ZTEST(mode_manager, test_a_mode_change_is_an_event)
{
	struct event event;

	wake_at(epoch + 9000);
	zassert_equal(set_mode(MODE_NOMINAL), 1);
	zassert_ok(event_take(&event));
	zassert_equal(event.app, APP_ID_MODE_MANAGER);
	zassert_equal(event.id, MODE_MANAGER_EVENT_MODE_CHANGED);
	zassert_equal(event.severity, SEVERITY_INFO);
	zassert_equal(event.arg0, MODE_NOMINAL);
	zassert_equal(event.arg1, MODE_REASON_GROUND_COMMAND);
	zassert_equal(event.met_ms, epoch + 9000, "timed from the latest tick (DS-25)");
	zassert_equal(event_take(&event), -ENOMSG, "one event a change");
}

ZTEST(mode_manager, test_a_new_reason_in_safe_mode_is_an_event)
{
	zassert_equal(request(MODE_SAFE, MODE_REASON_LOW_BATTERY), 1);
	expect_event(MODE_MANAGER_EVENT_MODE_CHANGED, MODE_SAFE, MODE_REASON_LOW_BATTERY);
}

ZTEST(mode_manager, test_a_refused_change_is_an_event)
{
	struct event event;

	zassert_equal(set_mode(MODE_DEPLOY), 0);
	zassert_ok(event_take(&event));
	zassert_equal(event.id, MODE_MANAGER_EVENT_CHANGE_REFUSED);
	zassert_equal(event.severity, SEVERITY_WARNING);
	zassert_equal(event.arg0, MODE_DEPLOY);
	zassert_equal(event.arg1, MODE_REASON_GROUND_COMMAND);

	/* A request with a reason no app may give. */
	zassert_equal(request(MODE_SAFE, MODE_REASON_GROUND_COMMAND), 0);
	expect_event(MODE_MANAGER_EVENT_CHANGE_REFUSED, MODE_SAFE, MODE_REASON_GROUND_COMMAND);
}

ZTEST(mode_manager, test_no_change_no_event)
{
	struct event event;

	zassert_equal(set_mode(MODE_SAFE), 1);
	zassert_equal(event_take(&event), -ENOMSG);
}
```
