## CMakeLists.txt
```
cmake_minimum_required(VERSION 3.20.0)

# Generate test_app's messages and channels along with the flight apps'.
set(SS_MESSAGES_EXTRA_APPS ${CMAKE_CURRENT_SOURCE_DIR}/apps)

find_package(Zephyr REQUIRED HINTS $ENV{ZEPHYR_BASE})
project(app_harness LANGUAGES C)

target_sources(app PRIVATE src/main.c src/test_app.c ../common/app_test.c)
target_include_directories(app PRIVATE ../common)
```

## prj.conf
```kconfig
CONFIG_ZTEST=y

CONFIG_SS_MESSAGES=y

# Test apps on top of the flight apps need a bigger pool than the default.
# Some headroom here, so adding a flight app doesn't break this test;
# resource_map.h's check still fails the build if this is too small.
CONFIG_ZBUS_MSG_SUBSCRIBER_NET_BUF_POOL_SIZE=56
```

## src/main.c
```c
/*
 * Smoke tests for the app test harness (tests/app/common).
 *
 * SPDX-License-Identifier: Apache-2.0
 *
 * They drive test_app (src/test_app.c) through its channels with the
 * harness helpers. Copy this layout when testing a real app.
 */

#include <zephyr/kernel.h>
#include <zephyr/zbus/zbus.h>
#include <zephyr/ztest.h>

#include "app_test.h"
#include "msg/common.h"
#include "msg/test_app.h"
#include "silversat/resource_map.h"

/* Generous: in simulated time a wait costs nothing unless it fails. */
#define WAIT K_SECONDS(1)

static struct app_status current_status(void)
{
	struct app_status status;

	zassert_ok(zbus_chan_read(&test_app_status_chan, &status, K_MSEC(10)));
	return status;
}

static struct test_app_hk current_hk(void)
{
	struct test_app_hk hk;

	zassert_ok(zbus_chan_read(&test_app_hk_chan, &hk, K_MSEC(10)));
	return hk;
}

static void set_value(int32_t value)
{
	const struct test_app_cmd cmd = {
		.id = TEST_APP_CMD_SET_VALUE,
		.args.set_value.value = value,
	};

	zassert_ok(zbus_chan_pub(&test_app_cmd_chan, &cmd, K_NO_WAIT));
}

ZTEST(app_harness, test_tick_carries_slot_and_uptime)
{
	struct frame_tick tick = app_test_tick(FRAME_SLOTS + 3);

	zassert_equal(tick.count, FRAME_SLOTS + 3);
	zassert_equal(tick.slot, 3);
	zassert_equal(tick.uptime_ms, k_uptime_get());
}

ZTEST(app_harness, test_wakeups_step_the_app)
{
	struct app_status before = current_status();
	struct app_status after;

	/* One wakeup at a time, as the frame manager delivers them. */
	for (uint32_t count = 0; count < 5; count++) {
		zassert_ok(app_test_wake(&test_app_wakeup_chan, count));
		zassert_ok(app_test_wait_status(&test_app_status_chan, before.steps + count + 1,
						0, WAIT, NULL));
	}

	after = current_status();
	zassert_equal(after.steps, before.steps + 5);
	zassert_equal(current_hk().last_count, 4);
}

ZTEST(app_harness, test_command_accepted)
{
	struct app_status before = current_status();
	struct app_status after;
	uint32_t handled = before.cmd_accepted + before.cmd_rejected;

	set_value(42);
	zassert_ok(app_test_wait_status(&test_app_status_chan, 0, handled + 1, WAIT, &after));
	zassert_equal(after.cmd_accepted, before.cmd_accepted + 1);
	zassert_equal(after.cmd_rejected, before.cmd_rejected);
	zassert_equal(current_hk().value, 42);
}

ZTEST(app_harness, test_command_rejected)
{
	struct app_status before;
	struct app_status after;
	uint32_t handled;

	set_value(7);
	before = current_status();
	handled = before.cmd_accepted + before.cmd_rejected;
	zassert_ok(app_test_wait_status(&test_app_status_chan, 0, handled + 1, WAIT, &before));
	handled++;

	/* A bad argument and an unknown command are both counted as rejected. */
	set_value(-1);
	const struct test_app_cmd unknown = {.id = 99};

	zassert_ok(zbus_chan_pub(&test_app_cmd_chan, &unknown, K_NO_WAIT));
	zassert_ok(app_test_wait_status(&test_app_status_chan, 0, handled + 2, WAIT, &after));
	zassert_equal(after.cmd_rejected, before.cmd_rejected + 2);
	zassert_equal(after.cmd_accepted, before.cmd_accepted);
	zassert_equal(current_hk().value, 7, "a rejected command must not change state");
}

ZTEST(app_harness, test_wait_times_out)
{
	struct app_status before = current_status();
	struct app_status got;

	/* Nothing is published, so the app never reaches this step count. */
	zassert_equal(app_test_wait_status(&test_app_status_chan, before.steps + 1, 0,
					   K_MSEC(50), &got),
		      -EAGAIN);
	zassert_equal(got.steps, before.steps);
}

ZTEST(app_harness, test_simulated_time)
{
	/*
	 * A day of simulated time passes in well under a second of real time;
	 * twister's timeout would stop the test long before a real day. (ztest
	 * reports this test's duration in simulated time, so it looks long.)
	 */
	struct app_status before = current_status();

	k_sleep(K_HOURS(24));
	zassert_ok(app_test_wake(&test_app_wakeup_chan, 0));
	zassert_ok(app_test_wait_status(&test_app_status_chan, before.steps + 1, 0, WAIT, NULL));
	zassert_true(current_hk().last_uptime_ms >= 24LL * 60 * 60 * 1000);
}

ZTEST_SUITE(app_harness, NULL, NULL, NULL, NULL, NULL);
```

## src/test_app.c
```c
/*
 * A test-only app, written the way every flight app is written (DS-10,
 * DS-14; design rationale section 9), so the harness is tested against the
 * real pattern.
 *
 * SPDX-License-Identifier: Apache-2.0
 */

#include <errno.h>

#include <zephyr/kernel.h>
#include <zephyr/zbus/zbus.h>

#include "msg/common.h"
#include "msg/test_app.h"
#include "silversat/resource_map.h"

/* Test-only. A flight app takes its stack size from the resource map. */
#define TEST_APP_STACK_SIZE 1024

/* The app's one pending point: every message it receives arrives here. */
ZBUS_MSG_SUBSCRIBER_DEFINE(test_app_sub);
ZBUS_CHAN_ADD_OBS(test_app_wakeup_chan, test_app_sub, 3);
ZBUS_CHAN_ADD_OBS(test_app_cmd_chan, test_app_sub, 3);

static struct app_status status;
static struct test_app_hk hk;

static void test_app_step(const struct frame_tick *tick)
{
	hk.last_count = tick->count;
	hk.last_uptime_ms = tick->uptime_ms;
}

static int test_app_dispatch(const struct test_app_cmd *cmd)
{
	switch (cmd->id) {
	case TEST_APP_CMD_SET_VALUE:
		if (cmd->args.set_value.value < 0) {
			return -EINVAL;
		}
		hk.value = cmd->args.set_value.value;
		return 0;
	default:
		return -ENOTSUP;
	}
}

static void test_app_main(void *a, void *b, void *c)
{
	const struct zbus_channel *chan;
	union test_app_msg msg;

	ARG_UNUSED(a);
	ARG_UNUSED(b);
	ARG_UNUSED(c);

	while (zbus_sub_wait_msg(&test_app_sub, &chan, &msg, K_FOREVER) == 0) {
		if (chan == &test_app_wakeup_chan) {
			test_app_step(&msg.tick);
			status.steps++;
		} else if (chan == &test_app_cmd_chan) {
			if (test_app_dispatch(&msg.cmd) == 0) {
				status.cmd_accepted++;
			} else {
				status.cmd_rejected++;
			}
		}
		/*
		 * Housekeeping first, then status: once a test sees the status
		 * change, the housekeeping it reads is already current.
		 */
		zbus_chan_pub(&test_app_hk_chan, &hk, K_NO_WAIT);
		zbus_chan_pub(&test_app_status_chan, &status, K_NO_WAIT);
	}
}

K_THREAD_DEFINE(test_app_tid, TEST_APP_STACK_SIZE, test_app_main, NULL, NULL, NULL,
		PRIORITY_1HZ, 0, 0);
```
