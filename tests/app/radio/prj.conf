## CMakeLists.txt
```
cmake_minimum_required(VERSION 3.20.0)

find_package(Zephyr REQUIRED HINTS $ENV{ZEPHYR_BASE})
project(radio_test LANGUAGES C)

target_sources(app PRIVATE src/main.c)
```

## prj.conf
```kconfig
# The flight path for ground commands and telemetry: radio, command
# ingest, telemetry output, and the frame manager that wakes them, with the
# flight frame tables. The mode manager boots into test mode, as on the
# bench: the test signal is present (app.overlay), so there is no
# separation delay (DS-42).
CONFIG_SS_MESSAGES=y
CONFIG_SS_FRAME_MANAGER=y
CONFIG_SS_COMMAND_INGEST=y
CONFIG_SS_RADIO=y
CONFIG_SS_TELEMETRY_OUTPUT=y
CONFIG_SS_MODE_MANAGER=y

# A Python simulator on the other end of the UART runs in real time, so
# the spacecraft must too (DS-92).
CONFIG_NATIVE_SIM_SLOWDOWN_TO_REAL_TIME=y

CONFIG_PRINTK=y
```

## app.overlay
```dts
/*
 * The radio UART is uart1, a pseudo-terminal the Python radio simulator
 * opens (DS-90). The test signal is an emulated pin, active low, so it is
 * present and the spacecraft boots into test mode (DS-42). Both the same as
 * app/boards/native_sim.overlay.
 */

/ {
	aliases {
		radio-uart = &uart1;
		test-mode-signal = &test_mode_signal;
	};

	test_mode_signal: test-mode-signal {
		compatible = "silversat,test-mode-signal";
		gpios = <&gpio0 1 GPIO_ACTIVE_LOW>;
	};
};

&uart1 {
	status = "okay";
};
```

## src/main.c
```c
/*
 * Radio end-to-end test image: the flight apps for ground commands, driven
 * by the Python tests in pytest/ through the radio UART.
 *
 * SPDX-License-Identifier: Apache-2.0
 *
 * Telemetry output sends the radio's housekeeping on the downlink only
 * once per round of apps, every few seconds. To keep the real-time tests
 * short, this also prints it once a second for them to read from the
 * console.
 */

#include <zephyr/kernel.h>
#include <zephyr/sys/printk.h>
#include <zephyr/zbus/zbus.h>

#include "msg/frame_manager.h"
#include "msg/radio.h"

int main(void)
{
	struct frame_manager_hk fm;
	struct radio_hk hk;

	/*
	 * The apps start themselves. The spacecraft boots in deploy mode, in
	 * which the radio doesn't run, and the mode manager moves to test mode
	 * at the end of the first major frame. Tell the test it can begin once
	 * the frame manager is running the test table.
	 */
	do {
		k_sleep(K_MSEC(100));
	} while (zbus_chan_read(&frame_manager_hk_chan, &fm, K_MSEC(10)) != 0 ||
		 fm.mode != MODE_TEST);
	printk("radio test ready\n");
	for (;;) {
		k_sleep(K_SECONDS(1));
		if (zbus_chan_read(&radio_hk_chan, &hk, K_MSEC(10)) == 0) {
			printk("radio hk: received=%u sent=%u bad_crc=%u bad_length=%u "
			       "bad_escape=%u too_long=%u lost=%u repeated=%u unknown_type=%u "
			       "uplink_dropped=%u rx_overrun=%u\n",
			       hk.frames_received, hk.frames_sent, hk.bad_crc, hk.bad_length,
			       hk.bad_escape, hk.too_long, hk.frames_lost, hk.frames_repeated,
			       hk.unknown_type, hk.uplink_dropped, hk.rx_overrun);
		}
	}
	return 0;
}
```
