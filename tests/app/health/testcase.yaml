## tests/app/mode_manager/testcase.yaml
```yaml
common:
  tags:
    - app
    - mode

tests:
  app.mode_manager:
    platform_allow:
      - native_sim
      - native_sim/native/64
```

## tests/app/nvm/testcase.yaml
```yaml
common:
  tags:
    - app
    - nvm

tests:
  app.nvm:
    platform_allow:
      - native_sim
      - native_sim/native/64
```

## tests/app/radio_emul/testcase.yaml
```yaml
common:
  tags:
    - app
    - radio

tests:
  app.radio_emul:
    platform_allow:
      - native_sim
      - native_sim/native/64
```

## tests/app/temperature/testcase.yaml
```yaml
common:
  tags:
    - app
    - temperature

  platform_allow:
    - native_sim
    - native_sim/native/64

tests:
  app.temperature: {}
  app.temperature.chip:
    extra_configs:
      - CONFIG_SS_TEMPERATURE_CHIP=y
```

## tests/app/temperature_no_sensor/testcase.yaml
```yaml
common:
  tags:
    - app
    - temperature

tests:
  app.temperature_no_sensor:
    platform_allow:
      - native_sim
      - native_sim/native/64
```

## tests/drivers/mag/testcase.yaml
```yaml
common:
  tags:
    - drivers
    - mag

tests:
  drivers.mag.emul:
    platform_allow:
      - native_sim
      - native_sim/native/64
```

## tests/fakes/dts/bindings/silversat,fake-fram.yaml
```yaml
# Copyright (c) 2026 SilverSat
# SPDX-License-Identifier: Apache-2.0

description: |
  A test-only FRAM (tests/fakes/fake_fram.c): RAM behind Zephyr's EEPROM
  API, with controls to fail, tear writes, and drop writes.

compatible: "silversat,fake-fram"

include: base.yaml

properties:
  size:
    type: int
    required: true
    description: Bytes.
```

## tests/fakes/dts/bindings/silversat,fake-retained-mem.yaml
```yaml
# Copyright (c) 2026 SilverSat
# SPDX-License-Identifier: Apache-2.0

description: |
  A test-only retained memory (tests/fakes/fake_retained_mem.c): RAM behind
  Zephyr's retained memory API, which a test can fail or corrupt. It stands
  in for the STM32's backup SRAM, the FRAM service's mirror.

compatible: "silversat,fake-retained-mem"

include: base.yaml

properties:
  size:
    type: int
    required: true
    description: Bytes.
```

## tests/fakes/dts/bindings/silversat,fake-temperature.yaml
```yaml
# Copyright (c) 2026 SilverSat
# SPDX-License-Identifier: Apache-2.0

description: |
  A test-only temperature sensor (tests/fakes/fake_temperature.c), behind
  Zephyr's sensor API, with controls to set its reading and make it fail.

compatible: "silversat,fake-temperature"

include: base.yaml
```

## tests/unit/cmd_route/testcase.yaml
```yaml
common:
  tags:
    - command

tests:
  unit.cmd_route:
    platform_allow:
      - native_sim
      - native_sim/native/64
```

## tests/unit/libs/testcase.yaml
```yaml
common:
  tags:
    - command
    - link

tests:
  unit.libs:
    platform_allow:
      - native_sim
      - native_sim/native/64
```

## tests/unit/link_codec/testcase.yaml
```yaml
common:
  tags:
    - link

tests:
  unit.link_codec:
    platform_allow:
      - native_sim
      - native_sim/native/64
```

## tests/unit/messages/testcase.yaml
```yaml
common:
  tags:
    - messages

tests:
  unit.messages:
    platform_allow:
      - native_sim
      - native_sim/native/64
```
